## Kconfig
```kconfig
# Copyright (c) 2019 HAW Hamburg
#
# This file is subject to the terms and conditions of the GNU Lesser
# General Public License v2.1. See the file LICENSE in the top level
# directory for more details.
#
mainmenu "RIOT Configuration"

orsource "boards/$(BOARD)/Kconfig"
rsource "cpu/$(CPU)/Kconfig"
rsource "cpu/Kconfig"

config COMPONENT_cpu
    bool
    default y

config COMPONENT_board
    bool
    default y

config COMPONENT_auto_init
    bool
    default y

config COMPONENT_sys
    bool
    default y

config COMPONENT_core
    bool
    default y

config COMPONENT_core_msg
    bool
    default y

menu "Board"
config NETDEV_DEFAULT
    bool "Enable default network devices"
    help
        Enable support for all network devices present in the board
config SAUL_DEFAULT
    bool "Enable default sensor and actuator devices"
    help
        Enable support for all sensor and actuator devices present in the board
endmenu # Defaults

# For now, get used modules as macros from this file (see kconfig.mk)
#osource "$(KCONFIG_GENERATED_DEPENDENCIES)"

rsource "drivers/Kconfig"
rsource "sys/Kconfig"
rsource "sys/net/Kconfig"
rsource "tests/Kconfig"

menu "Timers"
rsource "sys/xtimer/Kconfig"
endmenu # Timers

# The application may declare new symbols as well
osource "$(APPDIR)/Kconfig"

comment "RIOT is in a migration phase."
comment "Some configuration options may not be here. Use CFLAGS instead."
```

## Kconfig.test
```kconfig
mainmenu "To generate documentation"

menu "System"

menuconfig MODULE_FOO
    bool "Foo"
    help
        This will allow you to Foo.

if MODULE_FOO

config FOO_FACTOR
    int "Foo factor"
    default 4
    range 2 10
    help
        Will multiply the Foo by this.

config FOO_EXTRA
    bool "Some extra Foo"
    default y
    help
        Go extra on the Foo

endif # MODULE_FOO

menuconfig MODULE_BAR
    bool "Bar"
    help
        Get to Bar around.

if MODULE_BAR

choice
    bool "Bar mode"
    default BAR_MODE_ADV

config BAR_MODE_BASIC
    bool "Basic"
    help
        Not all the features for Bar.

config BAR_MODE_ADV
    bool "Advance"
    help
        You get a full-featured Bar.

endchoice

endif # MODULE_BAR

endmenu
```

## boards/b-l072z-lrwan1/Kconfig
```kconfig
config BOARD_B_L072Z_LRWAN1
    bool
    default y
    select HAS_periph_dma
    select HAS_periph_i2c
    select HAS_periph_rtc
    select HAS_periph_rtt
    select HAS_periph_spi
    select HAS_periph_spi_gpio_mode
    select HAS_periph_timer
    select HAS_periph_uart
    select HAS_riotboot
    select HAS_sx1276
```

## boards/cc2538dk/Kconfig
```kconfig
config HAS_periph_adc
    default y

config HAS_periph_i2c
    default y

config HAS_periph_spi
    default y

config HAS_periph_timer
    default y

config HAS_periph_uart
    default y

config HAS_emulator_renode
    default y
```

## boards/common/nrf52xxxdk/Kconfig
```kconfig
config HAS_periph_i2c
    default y

config HAS_periph_pwm
    default y

config HAS_periph_spi
    default y

config HAS_periph_uart
    default y

config COMPONENT_boards_common_nrf52xxdk
    bool
    default y
    help
        Common NRF52xxDK code.

source "$(RIOTBOARD)/common/nrf52/Kconfig"
```

## boards/common/nucleo144/Kconfig
```kconfig
# config COMPONENT_nucleo144_common
#     bool
#     default y

rsource "../nucleo/Kconfig"
```

## boards/common/silabs/Kconfig
```kconfig
config COMPONENT_boards_common_silabs
    bool

config COMPONENT_silabs_aem
    bool

config COMPONENT_silabs_bc
    bool
```

## boards/ek-lm4f120xl/Kconfig
```kconfig
config HAS_periph_adc
    default y

config HAS_periph_gpio
    default y

config HAS_periph_gpio_irq
    default y

config HAS_periph_spi
    default y

config HAS_periph_timer
    default y

config HAS_periph_uart
    default y
```

## boards/esp32-mh-et-live-minikit/Kconfig
```kconfig
config HAS_periph_adc
    default y

config HAS_periph_dac
    default y

config HAS_periph_i2c
    default y

config HAS_periph_pwm
    default y

config HAS_periph_spi
    default y

config HAS_arduino
    default y
```

## boards/esp32-olimex-evb/Kconfig
```kconfig
config HAS_periph_adc
    default y

config HAS_periph_i2c
    default y

config HAS_periph_pwm
    default y

config HAS_periph_spi
    default y

config HAS_periph_eth
    default y

config HAS_periph_can
    default y

config HAS_periph_ir
    default y

config HAS_arduino
    default y
```

## boards/esp32-ttgo-t-beam/Kconfig
```kconfig
config HAS_periph_adc
    default y

config HAS_periph_dac
    default y

config HAS_periph_i2c
    default y

config HAS_periph_pwm
    default y

config HAS_periph_spi
    default y

config HAS_periph_uart
    default y

config HAS_arduino
    default y

config HAS_esp_spi_ram
    default y
```

## boards/esp32-wrover-kit/Kconfig
```kconfig
config HAS_periph_adc
    default y

config HAS_periph_i2c
    default y

config HAS_periph_pwm
    default y

config HAS_periph_spi
    default y

config HAS_sdcard_spi
    default y

config HAS_esp_spi_ram
    default y

config HAS_arduino
    default y
```

## boards/feather-nrf52840/Kconfig
```kconfig
config HAS_periph_i2c
    default y

config HAS_periph_spi
    default y

config HAS_periph_uart
    default y

config HAS_periph_usbdev
    default y

config HAS_radio_nrf802154
    default y
```

## boards/hamilton/Kconfig
```kconfig
config HAS_periph_adc
    default y

config HAS_periph_gpio
    default y

config HAS_periph_gpio_irq
    default y

config HAS_periph_i2c
    default y

config HAS_periph_pwm
    default y

config HAS_periph_rtc
    default y

config HAS_periph_rtt
    default y

config HAS_periph_spi
    default y

config HAS_periph_timer
    default y
```

## boards/hifive1/Kconfig
```kconfig
config HAS_periph_rtc
    default y

config HAS_periph_rtt
    default y

config HAS_periph_spi
    default y

config HAS_periph_timer
    default y

config HAS_periph_uart
    default y
```

## boards/limifrog-v1/Kconfig
```kconfig
config HAS_periph_i2c
    default y

config HAS_periph_spi
    default y

config HAS_periph_timer
    default y

config HAS_periph_uart
    default y
```

## boards/lobaro-lorabox/Kconfig
```kconfig
config HAS_periph_i2c
    default y

config HAS_periph_rtc
    default y

config HAS_periph_spi
    default y

config HAS_periph_spi_gpio_mode
    default y

config HAS_periph_timer
    default y

config HAS_periph_uart
    default y
```

## boards/mulle/Kconfig
```kconfig
config HAS_periph_adc
    default y

config HAS_periph_dac
    default y

config HAS_periph_i2c
    default y

config HAS_periph_pwm
    default y

config HAS_periph_rtc
    default y

config HAS_periph_rtt
    default y

config HAS_periph_spi
    default y

config HAS_periph_timer
    default y

config HAS_periph_uart
    default y
```

## boards/native/Kconfig
```kconfig
config HAS_periph_rtc
    default y

config HAS_periph_timer
    default y

config HAS_periph_uart
    default y

config HAS_periph_gpio
    default y

config HAS_periph_pwm
    default y

config HAS_periph_qdec
    default y

config HAS_ethernet
    default y

config HAS_motor_driver
    default y
```
