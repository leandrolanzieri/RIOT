## drivers/mpu9x50/Kconfig
```kconfig
# Copyright (c) 2020 HAW Hamburg
#
# This file is subject to the terms and conditions of the GNU Lesser
# General Public License v2.1. See the file LICENSE in the top level
# directory for more details.

config HAS_mpu9x50
    bool

menuconfig COMPONENT_mpu9x50
    bool "MPU-9X50 (MPU9150 and MPU9250) accelerometer/magnetometer/gyroscope"
    default y if HAS_mpu9x50 && SAUL_DEFAULT
```

## drivers/mq3/Kconfig
```kconfig
# Copyright (c) 2020 HAW Hamburg
#
# This file is subject to the terms and conditions of the GNU Lesser
# General Public License v2.1. See the file LICENSE in the top level
# directory for more details.

config HAS_mq3
    bool

menuconfig COMPONENT_mq3
    bool "MQ-3 Alcohol Tester"
    default y if HAS_mq3
```

## drivers/mrf24j40/Kconfig
```kconfig
# Copyright (c) 2020 HAW Hamburg
#
# This file is subject to the terms and conditions of the GNU Lesser
# General Public License v2.1. See the file LICENSE in the top level
# directory for more details.

config HAS_mrf24j40
    bool

menuconfig COMPONENT_mrf24j40
    bool "MRF24J40 based drivers"
    default y if HAS_mrf24j40 && NETDEV_DEFAULT
    select HAS_HAS_NETDEV_IEEE802154
```

## drivers/mtd/Kconfig
```kconfig
# Copyright (c) 2020 HAW Hamburg
#
# This file is subject to the terms and conditions of the GNU Lesser
# General Public License v2.1. See the file LICENSE in the top level
# directory for more details.

config HAS_mtd
    bool

menuconfig COMPONENT_mtd
    bool "Memory Technology Device"
    default y if HAS_mtd
```

## drivers/my9221/Kconfig
```kconfig
# Copyright (c) 2020 HAW Hamburg
#
# This file is subject to the terms and conditions of the GNU Lesser
# General Public License v2.1. See the file LICENSE in the top level
# directory for more details.

config HAS_my9221
    bool

menuconfig COMPONENT_my9221
    bool "MY9221 LED controller"
    default y if HAS_my9221
```

## drivers/ncv7356/Kconfig
```kconfig
# Copyright (c) 2020 HAW Hamburg
#
# This file is subject to the terms and conditions of the GNU Lesser
# General Public License v2.1. See the file LICENSE in the top level
# directory for more details.

config HAS_ncv7356
    bool

menuconfig COMPONENT_ncv7356
    bool "NCV7356 Single Wire CAN Transceiver"
    default y if HAS_ncv7356
```

## drivers/netdev/Kconfig
```kconfig
# Copyright (c) 2021 HAW Hamburg
#
# This file is subject to the terms and conditions of the GNU Lesser
# General Public License v2.1. See the file LICENSE in the top level
# directory for more details.
#

menuconfig MODULE_NETDEV
    bool "netdev - Network Device Driver API"
    depends on TEST_KCONFIG

if MODULE_NETDEV

rsource "Kconfig.ieee802154"

endif # MODULE_NETDEV
```

## drivers/netdev/Kconfig.ieee802154
```kconfig
# Copyright (c) 2021 HAW Hamburg
#
# This file is subject to the terms and conditions of the GNU Lesser
# General Public License v2.1. See the file LICENSE in the top level
# directory for more details.
#

menuconfig MODULE_NETDEV_IEEE802154
    bool "IEEE 802.15.4 drivers"
    depends on TEST_KCONFIG
    select MODULE_IEEE802154
    select MODULE_RANDOM
    select MODULE_EUI_PROVIDER

if MODULE_NETDEV_IEEE802154

config MODULE_NETDEV_IEEE802154_MR_FSK
    bool "Multi-rate Frequency Shift Keying support (MR-FSK)"

config MODULE_NETDEV_IEEE802154_MR_OFDM
    bool "Multi-rate Orthogonal Frequency-Division Multiplexing support (MR-OFDM)"

config MODULE_NETDEV_IEEE802154_MR_OQPSK
    bool "Multi-rate Offset Quadrature Phase-Shift Keying support (MR-O-QPSK)"

config MODULE_NETDEV_IEEE802154_MULTIMODE
    bool "Multimode support"

config MODULE_NETDEV_IEEE802154_OQPSK
    bool "Offset Quadrature Phase-Shift Keying support (O-QPSK)"

config MODULE_NETDEV_IEEE802154_SUBMAC
    bool "Netdev IEEE 802.15.4 implementation using submac"
    select MODULE_IEEE802154_SUBMAC

endif # MODULE_NETDEV_IEEE802154
```

## drivers/netdev_eth/Kconfig
```kconfig
# Copyright (c) 2020 HAW Hamburg
#
# This file is subject to the terms and conditions of the GNU Lesser
# General Public License v2.1. See the file LICENSE in the top level
# directory for more details.

config HAS_netdev_eth
    bool

menuconfig COMPONENT_netdev_eth
    bool "Netdev Ethernet interface"
    default y if HAS_netdev_eth
    select HAS_HAS_NETDEV_ETHERNET
```

## drivers/nrf24l01p/Kconfig
```kconfig
# Copyright (c) 2020 HAW Hamburg
#
# This file is subject to the terms and conditions of the GNU Lesser
# General Public License v2.1. See the file LICENSE in the top level
# directory for more details.

config HAS_nrf24l01p
    bool

menuconfig COMPONENT_nrf24l01p
    bool "NRF24L01+ driver interface"
    default y if HAS_nrf24l01p
```

## drivers/opt3001/Kconfig
```kconfig
# Copyright (c) 2020 HAW Hamburg
#
# This file is subject to the terms and conditions of the GNU Lesser
# General Public License v2.1. See the file LICENSE in the top level
# directory for more details.

config HAS_opt3001
    bool

menuconfig COMPONENT_opt3001
    bool "OPT3001 Ambient Light Sensor"
    default y if HAS_opt3001 && SAUL_DEFAULT
```

## drivers/pca9685/Kconfig
```kconfig
# Copyright (c) 2020 HAW Hamburg
#
# This file is subject to the terms and conditions of the GNU Lesser
# General Public License v2.1. See the file LICENSE in the top level
# directory for more details.

config HAS_pca9685
    bool

menuconfig COMPONENT_pca9685
    bool "PCA9685 I2C PWM controller"
    default y if HAS_pca9685 && SAUL_DEFAULT
```

## drivers/pcd8544/Kconfig
```kconfig
# Copyright (c) 2020 HAW Hamburg
#
# This file is subject to the terms and conditions of the GNU Lesser
# General Public License v2.1. See the file LICENSE in the top level
# directory for more details.

config HAS_pcd8544
    bool

menuconfig COMPONENT_pcd8544
    bool "PCD8544 LCD driver"
    default y if HAS_pcd8544
```

## drivers/periph_common/Kconfig.crypto
```kconfig
# Copyright (c) 2022 HAW Hamburg
#
# This file is subject to the terms and conditions of the GNU Lesser
# General Public License v2.1. See the file LICENSE in the top level
# directory for more details.
#

menu "Crypto acceleration"

menu "Asymmetric crypto"

config MODULE_PERIPH_ECC_P192R1
    bool "ECC P192 acceleration peripheral driver"
    depends on HAS_PERIPH_ECC_P192R1

config MODULE_PERIPH_ECC_P256R1
    bool "ECC P256 acceleration peripheral driver"
    depends on HAS_PERIPH_ECC_P256R1

endmenu # Asymmetric crypto

menu "Hashing algorithms"

config MODULE_PERIPH_HASH_SHA_1
    bool "SHA-1 hash peripheral driver"
    depends on HAS_PERIPH_HASH_SHA_1

config MODULE_PERIPH_HASH_SHA_224
    bool "SHA-224 hash peripheral driver"
    depends on HAS_PERIPH_HASH_SHA_224

config MODULE_PERIPH_HASH_SHA_256
    bool "SHA-256 hash peripheral driver"
    depends on HAS_PERIPH_HASH_SHA_256

config MODULE_PERIPH_HASH_SHA_512
    bool "SHA-512 hash peripheral driver"
    depends on HAS_PERIPH_HASH_SHA_512

endmenu # Hashing algorithms

config MODULE_PERIPH_HMAC_SHA_256
    bool "HMAC SHA-256 peripheral driver"
    depends on HAS_PERIPH_HMAC_SHA_256

endmenu # Crypto acceleration
```

## drivers/periph_common/Kconfig.periph
```kconfig
has-own-periph-definition = $(own-periph-def-$(1))

comment "Platform has own definition of $(peripheral-str) peripheral"
    depends on $(has-own-periph-definition,$(peripheral))

if !$(has-own-periph-definition,$(peripheral))

config MODULE_$(peripheral)
    bool "$(peripheral-str) peripheral driver"
    depends on HAS_$(peripheral)

endif

if $(has-own-periph-definition,$(peripheral))
config MODULE_$(peripheral)
    bool "Platform-specific peripheral driver definition"
    depends on HAS_$(peripheral)
    depends on HAS_SOME_OTHER_DEP
    select SOME_OTHER_MODULE
endif

config HAS_$(peripheral)
    bool
    default y
    help
        Indicates that the $(peripheral-str) peripheral is available.

config HAS_SOME_OTHER_DEP
    bool "some other dep"

config SOME_OTHER_MODULE
    bool "Some other"
```

## drivers/ph_oem/Kconfig
```kconfig
# Copyright (c) 2020 HAW Hamburg
#
# This file is subject to the terms and conditions of the GNU Lesser
# General Public License v2.1. See the file LICENSE in the top level
# directory for more details.

config HAS_ph_oem
    bool

menuconfig COMPONENT_ph_oem
    bool "pH OEM sensor device driver"
    default y if HAS_ph_oem && SAUL_DEFAULT
```

## drivers/pn532/Kconfig
```kconfig
# Copyright (c) 2020 HAW Hamburg
#
# This file is subject to the terms and conditions of the GNU Lesser
# General Public License v2.1. See the file LICENSE in the top level
# directory for more details.

config HAS_pn532
    bool

menuconfig COMPONENT_pn532
    bool "PN532 NFC Reader"
    default y if HAS_pn532
    select HAS_HAS_NETDEV_NFC
```

## drivers/qmc5883l/Kconfig
```kconfig
# Copyright (c) 2020 HAW Hamburg
#
# This file is subject to the terms and conditions of the GNU Lesser
# General Public License v2.1. See the file LICENSE in the top level
# directory for more details.

config HAS_qmc5883l
    bool

menuconfig COMPONENT_qmc5883l
    bool "QMC5883L 3-Axis Digital Magnetic Sensor"
    default y if HAS_qmc5883l && SAUL_DEFAULT
```

## drivers/rgbled/Kconfig
```kconfig
# Copyright (c) 2020 HAW Hamburg
#
# This file is subject to the terms and conditions of the GNU Lesser
# General Public License v2.1. See the file LICENSE in the top level
# directory for more details.

config HAS_rgbled
    bool

menuconfig COMPONENT_rgbled
    bool "RGB-LED driver"
    default y if HAS_rgbled
```

## drivers/rn2xx3/Kconfig
```kconfig
# Copyright (c) 2020 HAW Hamburg
#
# This file is subject to the terms and conditions of the GNU Lesser
# General Public License v2.1. See the file LICENSE in the top level
# directory for more details.

config HAS_rn2xx3
    bool

menuconfig COMPONENT_rn2xx3
    bool "RN2483/RN2903 LoRa module driver"
    default y if HAS_rn2xx3
```

## drivers/saul/Kconfig
```kconfig
# Copyright (c) 2020 HAW Hamburg
#
# This file is subject to the terms and conditions of the GNU Lesser
# General Public License v2.1. See the file LICENSE in the top level
# directory for more details.

config HAS_saul
    bool

menuconfig COMPONENT_saul
    bool "[S]ensor [A]ctuator [U]ber [L]ayer"
    default y if HAS_saul && SAUL_DEFAULT
```

## drivers/sds011/Kconfig
```kconfig
# Copyright (c) 2020 HAW Hamburg
#
# This file is subject to the terms and conditions of the GNU Lesser
# General Public License v2.1. See the file LICENSE in the top level
# directory for more details.

config HAS_sds011
    bool

menuconfig COMPONENT_sds011
    bool "SDS011 Laser Dust Sensor"
    default y if HAS_sds011 && SAUL_DEFAULT
```

## drivers/servo/Kconfig
```kconfig
# Copyright (c) 2020 HAW Hamburg
#
# This file is subject to the terms and conditions of the GNU Lesser
# General Public License v2.1. See the file LICENSE in the top level
# directory for more details.

config HAS_servo
    bool

menuconfig COMPONENT_servo
    bool "Servo Motor Driver"
    default y if HAS_servo
```

## drivers/sht1x/Kconfig
```kconfig
# Copyright (c) 2020 HAW Hamburg
#
# This file is subject to the terms and conditions of the GNU Lesser
# General Public License v2.1. See the file LICENSE in the top level
# directory for more details.

config HAS_sht10
    bool
    select HAS_sht1x

config HAS_sht15
    bool
    select HAS_sht1x

config HAS_sht1x
    bool

menuconfig COMPONENT_sht1x
    bool "SHT10/SHT11/SHT15 Humidity and Temperature Sensor"
    default y if HAS_sht1x && SAUL_DEFAULT

if COMPONENT_sht1x
    choice
        bool "Select device model"
        default COMPONENT_sht10 if HAS_sht10
        default COMPONENT_sht15 if HAS_sht15

        config COMPONENT_sht10
            bool "SHT10"

        config COMPONENT_sht15
            bool "SHT15"

    endchoice
endif # COMPONENT_sht1x
```

## drivers/sht2x/Kconfig
```kconfig
# Copyright (c) 2020 HAW Hamburg
#
# This file is subject to the terms and conditions of the GNU Lesser
# General Public License v2.1. See the file LICENSE in the top level
# directory for more details.

config HAS_sht2x
    bool

menuconfig COMPONENT_sht2x
    bool "SHT2X"
    default y if HAS_sht2x && SAUL_DEFAULT
```
