## drivers/sht3x/Kconfig
```kconfig
# Copyright (c) 2020 HAW Hamburg
#
# This file is subject to the terms and conditions of the GNU Lesser
# General Public License v2.1. See the file LICENSE in the top level
# directory for more details.

config HAS_sht3x
    bool

menuconfig COMPONENT_sht3x
    bool "SHT3x Humidity and Temperature sensor"
    default y if HAS_sht3x && SAUL_DEFAULT
```

## drivers/shtc1/Kconfig
```kconfig
# Copyright (c) 2020 HAW Hamburg
#
# This file is subject to the terms and conditions of the GNU Lesser
# General Public License v2.1. See the file LICENSE in the top level
# directory for more details.

config HAS_shtc1
    bool

menuconfig COMPONENT_shtc1
    bool "SHTC1 Temperature and humidity sensor"
    default y if HAS_shtc1 && SAUL_DEFAULT
```

## drivers/si114x/Kconfig
```kconfig
# Copyright (c) 2020 HAW Hamburg
#
# This file is subject to the terms and conditions of the GNU Lesser
# General Public License v2.1. See the file LICENSE in the top level
# directory for more details.

config HAS_si114x
    bool

menuconfig COMPONENT_si114x
    bool "Si1145/6/7 UV/Ambient light/Proximity sensors"
    default y if HAS_si114x && SAUL_DEFAULT
```

## drivers/si70xx/Kconfig
```kconfig
# Copyright (c) 2020 HAW Hamburg
#
# This file is subject to the terms and conditions of the GNU Lesser
# General Public License v2.1. See the file LICENSE in the top level
# directory for more details.

config HAS_si7006
    bool
    select HAS_si70xx

config HAS_si7013
    bool
    select HAS_si70xx

config HAS_si7020
    bool
    select HAS_si70xx

config HAS_si7021
    bool
    select HAS_si70xx

config HAS_si70xx
    bool

menuconfig COMPONENT_si70xx
    bool "Si7006/13/20/21 temperature and humidity sensors"
    default y if HAS_si70xx && SAUL_DEFAULT

if COMPONENT_si70xx
    choice
        bool "Select device model"
        default COMPONENT_si7006 if HAS_si7006
        default COMPONENT_si7013 if HAS_si7013
        default COMPONENT_si7020 if HAS_si7020
        default COMPONENT_si7021 if HAS_si7021

        config COMPONENT_si7006
            bool "SI7006"

        config COMPONENT_si7013
            bool "SI7013"

        config COMPONENT_si7020
            bool "SI7020"

        config COMPONENT_si7021
            bool "SI7021"

    endchoice
endif # COMPONENT_si70xx
```

## drivers/srf04/Kconfig
```kconfig
# Copyright (c) 2020 HAW Hamburg
#
# This file is subject to the terms and conditions of the GNU Lesser
# General Public License v2.1. See the file LICENSE in the top level
# directory for more details.

config HAS_srf04
    bool

menuconfig COMPONENT_srf04
    bool "srf04 ultra sonic range finder"
    default y if HAS_srf04
```

## drivers/srf08/Kconfig
```kconfig
# Copyright (c) 2020 HAW Hamburg
#
# This file is subject to the terms and conditions of the GNU Lesser
# General Public License v2.1. See the file LICENSE in the top level
# directory for more details.

config HAS_srf08
    bool

menuconfig COMPONENT_srf08
    bool "SRF08 ultrasonic range sensor"
    default y if HAS_srf08
```

## drivers/stm32_eth/Kconfig
```kconfig
# Copyright (c) 2020 HAW Hamburg
#
# This file is subject to the terms and conditions of the GNU Lesser
# General Public License v2.1. See the file LICENSE in the top level
# directory for more details.

config HAS_stm32_eth
    bool

menuconfig COMPONENT_stm32_eth
    bool "STM32 Ethernet"
    default y if HAS_stm32_eth
    select HAS_HAS_NETDEV_ETHERNET
```

## drivers/sx127x/Kconfig
```kconfig
# Copyright (c) 2020 HAW Hamburg
#
# This file is subject to the terms and conditions of the GNU Lesser
# General Public License v2.1. See the file LICENSE in the top level
# directory for more details.

config HAS_sx1272
    bool
    select HAS_sx127x

config HAS_sx1276
    bool
    select HAS_sx127x

config HAS_sx127x
    bool

menuconfig COMPONENT_sx127x
    bool "Semtech SX1272 and SX1276 radios driver"
    default y if HAS_sx127x && NETDEV_DEFAULT
    select HAS_HAS_NETDEV_LORA

if COMPONENT_sx127x
    choice
        bool "Select device model"
        default COMPONENT_sx1272 if HAS_sx1272
        default COMPONENT_sx1276 if HAS_sx1276

        config COMPONENT_sx1272
            bool "SX1272"

        config COMPONENT_sx1276
            bool "SX1276"

    endchoice
endif # COMPONENT_sx127x
```

## drivers/tcs37727/Kconfig
```kconfig
# Copyright (c) 2020 HAW Hamburg
#
# This file is subject to the terms and conditions of the GNU Lesser
# General Public License v2.1. See the file LICENSE in the top level
# directory for more details.

config HAS_tcs37727
    bool

menuconfig COMPONENT_tcs37727
    bool "TCS37727 RGB Light Sensor"
    default y if HAS_tcs37727 && SAUL_DEFAULT
```

## drivers/tja1042/Kconfig
```kconfig
# Copyright (c) 2020 HAW Hamburg
#
# This file is subject to the terms and conditions of the GNU Lesser
# General Public License v2.1. See the file LICENSE in the top level
# directory for more details.

config HAS_tja1042
    bool

menuconfig COMPONENT_tja1042
    bool "TJA1042"
    default y if HAS_tja1042
    select HAS_HAS_NETDEV_CAN
```

## drivers/tmp00x/Kconfig
```kconfig
# Copyright (c) 2020 HAW Hamburg
#
# This file is subject to the terms and conditions of the GNU Lesser
# General Public License v2.1. See the file LICENSE in the top level
# directory for more details.

config HAS_tmp006
    bool
    select HAS_tmp00x

config HAS_tmp007
    bool
    select HAS_tmp00x

config HAS_tmp00x
    bool

menuconfig COMPONENT_tmp00x
    bool "TMP006/TMP007 Infrared Thermopile Sensor"
    default y if HAS_tmp00x && SAUL_DEFAULT

if COMPONENT_tmp00x
    choice
        bool "Select device model"
        default COMPONENT_tmp006 if HAS_tmp006
        default COMPONENT_tmp007 if HAS_tmp007

        config COMPONENT_tmp006
            bool "TMP006"

        config COMPONENT_tmp007
            bool "TMP007"

    endchoice
endif # COMPONENT_tmp00x
```

## drivers/tps6274x/Kconfig
```kconfig
# Copyright (c) 2020 HAW Hamburg
#
# This file is subject to the terms and conditions of the GNU Lesser
# General Public License v2.1. See the file LICENSE in the top level
# directory for more details.

config HAS_tps6274x
    bool

menuconfig COMPONENT_tps6274x
    bool "TPS6274x"
    default y if HAS_tps6274x
```

## drivers/tsl2561/Kconfig
```kconfig
# Copyright (c) 2020 HAW Hamburg
#
# This file is subject to the terms and conditions of the GNU Lesser
# General Public License v2.1. See the file LICENSE in the top level
# directory for more details.

config HAS_tsl2561
    bool

menuconfig COMPONENT_tsl2561
    bool "TSL2561 illuminance sensor"
    default y if HAS_tsl2561 && SAUL_DEFAULT
```

## drivers/tsl4531x/Kconfig
```kconfig
# Copyright (c) 2020 HAW Hamburg
#
# This file is subject to the terms and conditions of the GNU Lesser
# General Public License v2.1. See the file LICENSE in the top level
# directory for more details.

config HAS_tsl4531x
    bool

menuconfig COMPONENT_tsl4531x
    bool "TSL4531x Illuminance sensor"
    default y if HAS_tsl4531x && SAUL_DEFAULT
```

## drivers/uart_half_duplex/Kconfig
```kconfig
# Copyright (c) 2020 HAW Hamburg
#
# This file is subject to the terms and conditions of the GNU Lesser
# General Public License v2.1. See the file LICENSE in the top level
# directory for more details.

config HAS_uart_half_duplex
    bool

menuconfig COMPONENT_uart_half_duplex
    bool "Half Duplex UART driver"
    default y if HAS_uart_half_duplex
```

## drivers/vcnl40x0/Kconfig
```kconfig
# Copyright (c) 2020 HAW Hamburg
#
# This file is subject to the terms and conditions of the GNU Lesser
# General Public License v2.1. See the file LICENSE in the top level
# directory for more details.

config HAS_vcnl40x0
    bool

menuconfig COMPONENT_vcnl40x0
    bool "VCNL4010/VCNL4020/VCNL4040 Proximity and Ambient Light Sensors"
    default y if HAS_vcnl40x0 && SAUL_DEFAULT
```

## drivers/w5100/Kconfig
```kconfig
# Copyright (c) 2020 HAW Hamburg
#
# This file is subject to the terms and conditions of the GNU Lesser
# General Public License v2.1. See the file LICENSE in the top level
# directory for more details.

config HAS_w5100
    bool

menuconfig COMPONENT_w5100
    bool "W5100 ethernet driver"
    default y if HAS_w5100
    select HAS_HAS_NETDEV_ETHERNET
```

## drivers/ws281x/Kconfig
```kconfig
# Copyright (c) 2020 HAW Hamburg
#
# This file is subject to the terms and conditions of the GNU Lesser
# General Public License v2.1. See the file LICENSE in the top level
# directory for more details.

config HAS_ws281x
    bool

menuconfig COMPONENT_ws281x
    bool "WS2812/SK6812 RGB LED (NeoPixel)"
    default y if HAS_ws281x
```

## examples/crypto-ewsn2020_parallel_aes/Kconfig
```kconfig
config APPLICATION
    bool
    default y
    imply MOD_PERIPH_I2C_RECONFIGURE

config INPUT_512
    bool "Encrypt a block of 512 bytes"
    help
        The default is to use 32 bytes.
```

## examples/efm32_dma_crypto/Kconfig
```kconfig
config AES_WITH_DMA
    bool "Test AES using DMA"

choice
    bool "Number of bytes to encrypt"

config AES_NUMBYTES_16
    bool "16"

config AES_NUMBYTES_32
    bool "32"

endchoice
```

## examples/lwm2m_oscore/Kconfig
```kconfig
# Copyright (c) 2021 HAW Hamburg
#
# This file is subject to the terms and conditions of the GNU Lesser
# General Public License v2.1. See the file LICENSE in the top level
# directory for more details.
#

menu "Application configuration"

config LWM2M_SERVER_URI
    string "LwM2M Server URI to register"
    default "coap://[fd00:dead:beef::1]"
    help
        The host part of the URI MUST be a valid IPv6 address.

config LWM2M_SERVER_SHORT_ID
    int "Server Short ID"
    default 1
    range 1 65534

menu "OSCORE Pre-shared parameters"

config OSCORE_MASTER_SECRET
    string "Master secret"
    default "0123456789abcdef"

config OSCORE_MASTER_SALT
    string "Master salt"
    default "mastersalt"

config OSCORE_RECIPIENT_ID
    string "Recipient id"
    default "r"

config OSCORE_SENDER_ID
    string "Sender id"
    default "s"

endmenu

endmenu # Application configuration
```

## examples/wakaama/Kconfig
```kconfig
# Copyright (c) 2021 HAW Hamburg
#
# This file is subject to the terms and conditions of the GNU Lesser
# General Public License v2.1. See the file LICENSE in the top level
# directory for more details.
#

menu "Application configuration"

menu "Server configuration"

config LWM2M_SERVER_URI
    string "LwM2M Server URI to register/bootstrap with"
    default "coap://[fd00:dead:beef::1]"
    help
        The host part of the URI MUST be a valid IPv6 address.

config LWM2M_SERVER_SHORT_ID
    int "Server Short ID"
    default 1
    range 1 65534

config PSK_ID
    string "PSK Identity"
    default "Client_Identity"

config PSK_KEY
    string "PSK Key"
    default "ThisIsRIOT!"

config LWM2M_SERVER_IS_BOOTSTRAP
    bool "The server is a Bootstrap-Server"
    depends on LWM2M_BOOTSTRAP

endmenu

menu "Client configuration"

config LWM2M_CLIENT_URI
    string "LwM2M client URI to test C2C communication with"
    default "coap://[fd00:dead:beef::1]"
    help
        The host part of the URI MUST be a valid IPv6 address.

config LWM2M_CLIENT_SHORT_ID
    int "Client Short ID"
    default 1
    range 1 65534

choice
    bool "Security mode"

config LWM2M_CLIENT_SECURITY_NONE
    bool "None"

config LWM2M_CLIENT_SECURITY_PSK
    bool "Pre-Shared Keys"

endchoice

if LWM2M_CLIENT_SECURITY_PSK

config LWM2M_CLIENT_PSK_ID
    string "PSK Identity"
    default "C2C_Identity"

config LWM2M_CLIENT_PSK_KEY
    string "PSK Key"
    default "C2CRocks!"

endif

endmenu

endmenu # Application configuration
```
