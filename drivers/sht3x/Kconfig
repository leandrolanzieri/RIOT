## hwd/dts/arm/stm32/stm32l1/stm32l152re/board.yml
```yaml
board:
  name: 'Nucleo L152RE'
  cpu: 'stm32/stm32l1/stm32l152re/stm32l152re.yml'
  description: >
    STM32 Nucleo-64 development board with STM32L152RE MCU, supports Arduino
    and ST morpho connectivity
  pinmap:
    CN5:
      - label: 'D8'
        pin: 'PA9'
      - label: 'PWM/D9'
        pin: 'PC7'
      - label: 'PWM/CS/D10'
        pin: 'PB6'
      - label: 'PWM/MOSI/D11'
        pin: 'PA7'
      - label: 'MISO/D12'
        pin: 'PA6'
      - label: 'SCK/D13'
        pin: 'PA5'
      - label: 'GND'
        pin: 'GND'
      - label: 'AVDD'
        pin: 'AVDD'
      - label: 'SDA/D14'
        pin: 'PB9'
      - label: 'SCL/D15'
        pin: 'PB8'
    CN6:
      - label: 'NC'
        pin: 'NC'
      - label: 'IOREF'
        pin: 'IOREF'
      - label: 'RESET'
        pin: 'RESET'
      - label: '+3V3'
        pin: '+3V3'
      - label: '+5V'
        pin: '+5V'
      - label: 'GND'
        pin: 'GND'
      - label: 'GND'
        pin: 'GND'
      - label: 'VIN'
        pin: 'VIN'
    CN7:
      - label: 'PC10'
        pin: 'PC10'
      - label: 'PC11'
        pin: 'PC11'
      - label: 'PC12'
        pin: 'PC12'
      - label: 'PD2'
        pin: 'PD2'
      - label: 'VDD'
        pin: 'VDD'
      - label: 'E5V'
        pin: 'E5V'
      - label: 'BOOT0'
        pin: 'BOOT0'
      - label: 'GND'
        pin: 'GND'
      - label: 'NC'
        pin: 'NC'
      - label: 'NC'
        pin: 'NC'
      - label: 'NC'
        pin: 'NC'
      - label: 'IOREF'
        pin: 'IOREF'
      - label: 'PA13'
        pin: 'PA13'
      - label: 'RESET'
        pin: 'RESET'
      - label: 'PA14'
        pin: 'PA14'
      - label: '+3V3'
        pin: '+3V3'
      - label: 'PA15'
        pin: 'PA15'
      - label: '+5V'
        pin: '+5V'
      - label: 'GND'
        pin: 'GND'
      - label: 'GND'
        pin: 'GND'
      - label: 'PB7'
        pin: 'PB7'
      - label: 'GND'
        pin: 'GND'
      - label: 'PC13'
        pin: 'PC13'
      - label: 'VIN'
        pin: 'VIN'
      - label: 'PC14'
        pin: 'PC14'
      - label: 'NC'
        pin: 'NC'
      - label: 'PC15'
        pin: 'PC15'
      - label: 'PA0'
        pin: 'PA0'
      - label: 'PH0'
        pin: 'PH0'
      - label: 'PA1'
        pin: 'PA1'
      - label: 'PH1'
        pin: 'PH1'
      - label: 'PA4'
        pin: 'PA4'
      - label: 'VBAT'
        pin: 'VBAT'
      - label: 'PB0'
        pin: 'PB0'
      - label: 'PC2'
        pin: 'PC2'
      - label: 'PC1'
        pin: 'PC1'
      - label: 'PC3'
        pin: 'PC3'
      - label: 'PC0'
        pin: 'PC0'
    CN8:
      - label: 'A0'
        pin: 'PA0'
      - label: 'A1'
        pin: 'PA1'
      - label: 'A2'
        pin: 'PA4'
      - label: 'A3'
        pin: 'PB0'
      - label: 'A4'
        pin: 'PC1'
      - label: 'A5'
        pin: 'PC0'
    CN9:
      - label: 'RX/D0'
        pin: 'PA3'
      - label: 'TX/D1'
        pin: 'PA2'
      - label: 'D2'
        pin: 'PA10'
      - label: 'PWM/D3'
        pin: 'PB3'
      - label: 'D4'
        pin: 'PB5'
      - label: 'PWM/D5'
        pin: 'PB4'
      - label: 'PWM/D6'
        pin: 'PB10'
      - label: 'D7'
        pin: 'PA8'
    CN10:
      - label: 'PC9'
        pin: 'PC9'
      - label: 'PC8'
        pin: 'PC8'
      - label: 'PB8'
        pin: 'PB8'
      - label: 'PC6'
        pin: 'PC6'
      - label: 'PB9'
        pin: 'PB9'
      - label: 'PC5'
        pin: 'PC5'
      - label: 'AVDD'
        pin: 'AVDD'
      - label: 'U5V'
        pin: 'U5V'
      - label: 'GND'
        pin: 'GND'
      - label: 'NC'
        pin: 'NC'
      - label: 'PA5'
        pin: 'PA5'
      - label: 'PA12'
        pin: 'PA12'
      - label: 'PA6'
        pin: 'PA6'
      - label: 'PA11'
        pin: 'PA11'
      - label: 'PA7'
        pin: 'PA7'
      - label: 'PB12'
        pin: 'PB12'
      - label: 'PB6'
        pin: 'PB6'
      - label: 'PB11'
        pin: 'PB11'
      - label: 'PC7'
        pin: 'PC7'
      - label: 'GND'
        pin: 'GND'
      - label: 'PA9'
        pin: 'PA9'
      - label: 'PB2'
        pin: 'PB2'
      - label: 'PA8'
        pin: 'PA8'
      - label: 'PB1'
        pin: 'PB1'
      - label: 'PB10'
        pin: 'PB10'
      - label: 'PB15'
        pin: 'PB15'
      - label: 'PB4'
        pin: 'PB4'
      - label: 'PB14'
        pin: 'PB14'
      - label: 'PB5'
        pin: 'PB5'
      - label: 'PB13'
        pin: 'PB13'
      - label: 'PB3'
        pin: 'PB3'
      - label: 'AGND'
        pin: 'AGND'
      - label: 'PA10'
        pin: 'PA10'
      - label: 'PC4'
        pin: 'PC4'
      - label: 'PA2'
        pin: 'PA2'
      - label: 'NC'
        pin: 'NC'
      - label: 'PA3'
        pin: 'PA3'
      - label: 'NC'
        pin: 'NC'
    BTN:
      - label: 'USER/B1'
        pin: 'PC13'
      - label: 'RESET/B2'
        pin: 'RESET'
    LED:
      - label: 'LD2'
        pin: 'PA5'
```
