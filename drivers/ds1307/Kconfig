## drivers/ds1307/Kconfig
```kconfig
# Copyright (c) 2020 HAW Hamburg
#
# This file is subject to the terms and conditions of the GNU Lesser
# General Public License v2.1. See the file LICENSE in the top level
# directory for more details.

config HAS_ds1307
    bool

menuconfig COMPONENT_ds1307
    bool "DS1307 RTC"
    default y if HAS_ds1307
```

## drivers/ds3234/Kconfig
```kconfig
# Copyright (c) 2020 HAW Hamburg
#
# This file is subject to the terms and conditions of the GNU Lesser
# General Public License v2.1. See the file LICENSE in the top level
# directory for more details.

config HAS_ds3234
    bool

menuconfig COMPONENT_ds3234
    bool "DS3234 Extremely Accurate SPI RTC"
    default y if HAS_ds3234
```

## drivers/ds75lx/Kconfig
```kconfig
# Copyright (c) 2020 HAW Hamburg
#
# This file is subject to the terms and conditions of the GNU Lesser
# General Public License v2.1. See the file LICENSE in the top level
# directory for more details.

config HAS_ds75lx
    bool

menuconfig COMPONENT_ds75lx
    bool "Maxim DS75LX temperature sensor"
    default y if HAS_ds75lx && SAUL_DEFAULT
```

## drivers/enc28j60/Kconfig
```kconfig
# Copyright (c) 2020 HAW Hamburg
#
# This file is subject to the terms and conditions of the GNU Lesser
# General Public License v2.1. See the file LICENSE in the top level
# directory for more details.

config HAS_enc28j60
    bool

menuconfig COMPONENT_enc28j60
    bool "ENC28J60"
    default y if HAS_enc28j60
    select HAS_HAS_NETDEV_ETHERNET
```

## drivers/encx24j600/Kconfig
```kconfig
# Copyright (c) 2020 HAW Hamburg
#
# This file is subject to the terms and conditions of the GNU Lesser
# General Public License v2.1. See the file LICENSE in the top level
# directory for more details.

config HAS_encx24j600
    bool

menuconfig COMPONENT_encx24j600
    bool "ENCX24J600"
    default y if HAS_encx24j600
    select HAS_HAS_NETDEV_ETHERNET
```

## drivers/fxos8700/Kconfig
```kconfig
# Copyright (c) 2020 HAW Hamburg
#
# This file is subject to the terms and conditions of the GNU Lesser
# General Public License v2.1. See the file LICENSE in the top level
# directory for more details.

config HAS_fxos8700
    bool

menuconfig COMPONENT_fxos8700
    bool "FXOS8700 3-axis accelerometer/magnetometer"
    default y if HAS_fxos8700 && SAUL_DEFAULT
```

## drivers/hd44780/Kconfig
```kconfig
# Copyright (c) 2020 HAW Hamburg
#
# This file is subject to the terms and conditions of the GNU Lesser
# General Public License v2.1. See the file LICENSE in the top level
# directory for more details.

config HAS_hd44780
    bool

menuconfig COMPONENT_hd44780
    bool "HD44780 LCD driver"
    default y if HAS_hd44780
```

## drivers/hdc1000/Kconfig
```kconfig
# Copyright (c) 2020 HAW Hamburg
#
# This file is subject to the terms and conditions of the GNU Lesser
# General Public License v2.1. See the file LICENSE in the top level
# directory for more details.

config HAS_hdc1000
    bool

menuconfig COMPONENT_hdc1000
    bool "HDC1000 Humidity and Temperature Sensor"
    default y if HAS_hdc1000 && SAUL_DEFAULT
```

## drivers/hih6130/Kconfig
```kconfig
# Copyright (c) 2020 HAW Hamburg
#
# This file is subject to the terms and conditions of the GNU Lesser
# General Public License v2.1. See the file LICENSE in the top level
# directory for more details.

config HAS_hih6130
    bool

menuconfig COMPONENT_hih6130
    bool "HIH6130 humidity and temperature sensor"
    default y if HAS_hih6130
```

## drivers/hts221/Kconfig
```kconfig
# Copyright (c) 2020 HAW Hamburg
#
# This file is subject to the terms and conditions of the GNU Lesser
# General Public License v2.1. See the file LICENSE in the top level
# directory for more details.

config HAS_hts221
    bool

menuconfig COMPONENT_hts221
    bool "ST HTS221 digital Humidity Sensor"
    default y if HAS_hts221 && SAUL_DEFAULT
```

## drivers/ina2xx/Kconfig
```kconfig
# Copyright (c) 2020 HAW Hamburg
#
# This file is subject to the terms and conditions of the GNU Lesser
# General Public License v2.1. See the file LICENSE in the top level
# directory for more details.

config HAS_ina2xx
    bool

menuconfig COMPONENT_ina2xx
    bool "INA2XX current/power monitor"
    default y if HAS_ina2xx && SAUL_DEFAULT
```

## drivers/isl29125/Kconfig
```kconfig
# Copyright (c) 2020 HAW Hamburg
#
# This file is subject to the terms and conditions of the GNU Lesser
# General Public License v2.1. See the file LICENSE in the top level
# directory for more details.

config HAS_isl29125
    bool

menuconfig COMPONENT_isl29125
    bool "ISL29125 RGB light sensor"
    default y if HAS_isl29125
```

## drivers/itg320x/Kconfig
```kconfig
# Copyright (c) 2020 HAW Hamburg
#
# This file is subject to the terms and conditions of the GNU Lesser
# General Public License v2.1. See the file LICENSE in the top level
# directory for more details.

config HAS_itg320x
    bool

menuconfig COMPONENT_itg320x
    bool "ITG320X 3-axis gyroscope"
    default y if HAS_itg320x && SAUL_DEFAULT
```

## drivers/kw2xrf/Kconfig
```kconfig
# Copyright (c) 2020 HAW Hamburg
#
# This file is subject to the terms and conditions of the GNU Lesser
# General Public License v2.1. See the file LICENSE in the top level
# directory for more details.

config HAS_kw2xrf
    bool

menuconfig COMPONENT_kw2xrf
    bool "KW2x radio-driver"
    default y if HAS_kw2xrf && NETDEV_DEFAULT
    select HAS_HAS_NETDEV_IEEE802154
```

## drivers/lc709203f/Kconfig
```kconfig
# Copyright (c) 2020 HAW Hamburg
#
# This file is subject to the terms and conditions of the GNU Lesser
# General Public License v2.1. See the file LICENSE in the top level
# directory for more details.

config HAS_lc709203f
    bool

menuconfig COMPONENT_lc709203f
    bool "LC709203F"
    default y if HAS_lc709203f
```

## drivers/lis2dh12/Kconfig
```kconfig
# Copyright (c) 2020 HAW Hamburg
#
# This file is subject to the terms and conditions of the GNU Lesser
# General Public License v2.1. See the file LICENSE in the top level
# directory for more details.

config HAS_lis2dh12
    bool

menuconfig COMPONENT_lis2dh12
    bool "LIS2DH12 Accelerometer"
    default y if HAS_lis2dh12 && SAUL_DEFAULT
```

## drivers/lis3dh/Kconfig
```kconfig
# Copyright (c) 2020 HAW Hamburg
#
# This file is subject to the terms and conditions of the GNU Lesser
# General Public License v2.1. See the file LICENSE in the top level
# directory for more details.

config HAS_lis3dh
    bool

menuconfig COMPONENT_lis3dh
    bool "LIS3DH accelerometer"
    default y if HAS_lis3dh && SAUL_DEFAULT
    select HAS_HAS_NETDEV_BLE
```

## drivers/lis3mdl/Kconfig
```kconfig
# Copyright (c) 2020 HAW Hamburg
#
# This file is subject to the terms and conditions of the GNU Lesser
# General Public License v2.1. See the file LICENSE in the top level
# directory for more details.

config HAS_lis3mdl
    bool

menuconfig COMPONENT_lis3mdl
    bool "LIS3MDL 3-axis magnetometer"
    default y if HAS_lis3mdl && SAUL_DEFAULT
```

## drivers/lpsxxx/Kconfig
```kconfig
# Copyright (c) 2020 HAW Hamburg
#
# This file is subject to the terms and conditions of the GNU Lesser
# General Public License v2.1. See the file LICENSE in the top level
# directory for more details.

config HAS_lps22hb
    bool
    select HAS_lpsxxx

config HAS_lps25hb
    bool
    select HAS_lpsxxx

config HAS_lps331ap
    bool
    select HAS_lpsxxx

config HAS_lpsxxx
    bool

menuconfig COMPONENT_lpsxxx
    bool "LPS331AP/LPS25HB/LPS22HB Pressure Sensors Driver"
    default y if HAS_lpsxxx && SAUL_DEFAULT

if COMPONENT_lpsxxx
    choice
        bool "Select device model"
        default COMPONENT_lps22hb if HAS_lps22hb
        default COMPONENT_lps25hb if HAS_lps25hb
        default COMPONENT_lps331ap if HAS_lps331ap

        config COMPONENT_lps22hb
            bool "LPS22HB"

        config COMPONENT_lps25hb
            bool "LPS25HB"

        config COMPONENT_lps331ap
            bool "LPS331AP"

    endchoice
endif # COMPONENT_lpsxxx
```

## drivers/lsm303dlhc/Kconfig
```kconfig
# Copyright (c) 2020 HAW Hamburg
#
# This file is subject to the terms and conditions of the GNU Lesser
# General Public License v2.1. See the file LICENSE in the top level
# directory for more details.

config HAS_lsm303dlhc
    bool

menuconfig COMPONENT_lsm303dlhc
    bool "LSM303DLHC 3D accelerometer/magnetometer"
    default y if HAS_lsm303dlhc && SAUL_DEFAULT
    select HAS_HAS_NETDEV_BLE
```

## drivers/lsm6dsl/Kconfig
```kconfig
# Copyright (c) 2020 HAW Hamburg
#
# This file is subject to the terms and conditions of the GNU Lesser
# General Public License v2.1. See the file LICENSE in the top level
# directory for more details.

config HAS_lsm6dsl
    bool

menuconfig COMPONENT_lsm6dsl
    bool "LSM6DSL 3D accelerometer/gyroscope"
    default y if HAS_lsm6dsl && SAUL_DEFAULT
```

## drivers/mag3110/Kconfig
```kconfig
# Copyright (c) 2020 HAW Hamburg
#
# This file is subject to the terms and conditions of the GNU Lesser
# General Public License v2.1. See the file LICENSE in the top level
# directory for more details.

config HAS_mag3110
    bool

menuconfig COMPONENT_mag3110
    bool "MAG3110 3-Axis Digital Magnetometer"
    default y if HAS_mag3110 && SAUL_DEFAULT
```

## drivers/mma8x5x/Kconfig
```kconfig
# Copyright (c) 2020 HAW Hamburg
#
# This file is subject to the terms and conditions of the GNU Lesser
# General Public License v2.1. See the file LICENSE in the top level
# directory for more details.

config HAS_mma8x5x
    bool

menuconfig COMPONENT_mma8x5x
    bool "MMA8x5x Accelerometer"
    default y if HAS_mma8x5x && SAUL_DEFAULT
```

## drivers/motor_driver/Kconfig
```kconfig
# Copyright (c) 2020 HAW Hamburg
#
# This file is subject to the terms and conditions of the GNU Lesser
# General Public License v2.1. See the file LICENSE in the top level
# directory for more details.

config HAS_motor_driver
    bool

menuconfig COMPONENT_motor_driver
    bool "Generic DC Motor Driver"
    default y if HAS_motor_driver
```

## drivers/mpl3115a2/Kconfig
```kconfig
# Copyright (c) 2020 HAW Hamburg
#
# This file is subject to the terms and conditions of the GNU Lesser
# General Public License v2.1. See the file LICENSE in the top level
# directory for more details.

config HAS_mpl3115a2
    bool

menuconfig COMPONENT_mpl3115a2
    bool "MPL3115A2 Pressure Sensor"
    default y if HAS_mpl3115a2 && SAUL_DEFAULT
```
