## sys/shell/Kconfig
```kconfig
# Copyright (c) 2020 HAW Hamburg
#
# This file is subject to the terms and conditions of the GNU Lesser
# General Public License v2.1. See the file LICENSE in the top level
# directory for more details.
#
menuconfig COMPONENT_shell
    bool "Use Shell"
    default y
    depends on COMPONENT_stdio_uart_rx

if COMPONENT_shell

config COMPONENT_shell_commands
    bool "Use shell commands"
    default y

config COMPONENT_gnrc_netif_cmd_lora
    bool "Use LoRaWAN shell commands"
    default y
    depends on COMPONENT_shell_commands

config COMPONENT_gnrc_icmpv6_echo
    bool "Enable ping command"
    default y
    depends on COMPONENT_gnrc_icmpv6
    depends on COMPONENT_shell_commands

config COMPONENT_gnrc_txtsnd
    bool "Enable txtsnd command"
    default y
    depends on COMPONENT_gnrc_netif
    depends on COMPONENT_shell_commands

endif # COMPONENT_shell
```

## sys/ztimer/Kconfig
```kconfig
# Copyright (c) 2022 HAW Hamburg
#
# This file is subject to the terms and conditions of the GNU Lesser
# General Public License v2.1. See the file LICENSE in the top level
# directory for more details.
#

menuconfig MODULE_ZTIMER
    bool "ztimer - High level timer abstraction layer"
    select MODULE_ZTIMER_CORE
    select MODULE_ZTIMER_CONVERT_FRAC
    select MODULE_ZTIMER_CONVERT_SHIFT
    select MODULE_ZTIMER_EXTEND

if MODULE_ZTIMER

menu "Clocks"

config MODULE_ZTIMER_USEC
    bool "Microseconds"
    depends on MODULE_ZTIMER_PERIPH_TIMER

config MODULE_ZTIMER_MSEC
    bool "Milliseconds"
    depends on MODULE_ZTIMER_PERIPH_RTT || MODULE_ZTIMER_PERIPH_TIMER

config MODULE_ZTIMER_SEC
    bool "Seconds"
    depends on MODULE_ZTIMER_PERIPH_RTC || MODULE_ZTIMER_PERIPH_RTT || MODULE_ZTIMER_PERIPH_TIMER

endmenu # Clocks

menu "Ztimer hardware backends"

config MODULE_ZTIMER_NO_PERIPH_RTT
    bool "Disable ztimer_periph_rtt auto-inclusion"
    help
        This module disables the auto-inclusion of ztimer_periph_rtt as a backend
        for ztimer_msec and ztimer_sec.

config MODULE_ZTIMER_PERIPH_RTC
    bool "RTC peripheral"
    depends on MODULE_PERIPH_RTC

config MODULE_ZTIMER_PERIPH_RTT
    bool "RTT peripheral"
    depends on MODULE_PERIPH_RTT
    depends on !MODULE_ZTIMER_NO_PERIPH_RTT

config MODULE_ZTIMER_PERIPH_PTP
    bool "PTP peripheral"
    depends on MODULE_PERIPH_PTP_TIMER

config MODULE_ZTIMER_PERIPH_TIMER
    bool "Timer peripheral"
    depends on MODULE_PERIPH_TIMER

endmenu # Backends

menu "Frequency conversion"

config MODULE_ZTIMER_CONVERT_MULDIV64
    bool "64-bits arithmetic conversion"
    select MODULE_ZTIMER_CONVERT
    help
        muldiv64 is very precise, but the overhead is the highest. On MCUs
        without hardware division this might not be a good choice.

config MODULE_ZTIMER_CONVERT_SHIFT
    bool
    select MODULE_ZTIMER_CONVERT
    help
        Shift conversion is both fast and super precise, but cannot work for
        arbitrary frequencies. It's kind of a software prescaler for the
        underlying clock. So if the hardware clock frequency and the target
        clock frequency differ by a factor that is a power of two, this is the
        best choice - otherwise it is simply not usable.

config MODULE_ZTIMER_CONVERT_FRAC
    bool
    select MODULE_ZTIMER_CONVERT
    depends on MODULE_FRAC
    help
        Frac can be used for arbitrary frequency conversions, but trades in
        precision to gain speed. In cases where shift conversion cannot be used,
        this is likely the best trade off.

config MODULE_ZTIMER_CONVERT
    bool

endmenu # Frequency conversion


menu "xtimer and evtimer compatibility"

choice
    bool "xtimer compatibility"
    depends on MODULE_XTIMER && MODULE_ZTIMER

config MODULE_ZTIMER_XTIMER_COMPAT
    bool "map xtimer calls to ztimer"
    select MODULE_DIV
    select MODULE_ZTIMER_USEC
    select MODULE_ZTIMER_PERIPH_TIMER
    help
        This is a wrapper of xtimer API on ztimer_usec.

config MODULE_XTIMER_ON_ZTIMER
    bool "ztimer_usec as timer backend for xtimer"
    select MODULE_ZTIMER_USEC
    select MODULE_ZTIMER_PERIPH_TIMER
endchoice

config MODULE_ZTIMER64_XTIMER_COMPAT
    bool "map xtimer calls to ztimer64"
    select MODULE_DIV
    select MODULE_ZTIMER64
    select MODULE_ZTIMER64_USEC
    help
        This is a wrapper of xtimer API on ztimer64_usec.

config MODULE_EVTIMER_ON_ZTIMER
    bool "Use ztimer_msec as timer backend for evtimer"
    depends on MODULE_ZTIMER_MSEC

endmenu # xtimer compatibility

config MODULE_ZTIMER
    bool
    depends on TEST_KCONFIG


config MODULE_AUTO_INIT_ZTIMER
    bool "Auto initialize ztimer"
    depends on MODULE_AUTO_INIT
    select MODULE_ZTIMER_INIT
    default y

config MODULE_ZTIMER_AUTO_ADJUST
    bool "Auto adjust ztimer set and sleep values"
    select MODULE_ZTIMER_OVERHEAD

config MODULE_ZTIMER_NOW64
    bool "Use a 64-bits result for ztimer_now()"

config MODULE_ZTIMER_OVERHEAD
    bool "Overhead measurement functionalities"

config MODULE_ZTIMER_MOCK
    bool "Mock backend (for testing only)"
    help
        This ztimer module implements a virtual clock that can be used for
        unittests. It can be manually adjusted to different timestamps and
        manually fired to simulate different scenarios and test the ztimer
        implementation using this as a backing timer.

config MODULE_ZTIMER_INIT
    bool

config MODULE_ZTIMER_CORE
    bool

config MODULE_ZTIMER_EXTEND
    bool

endif # MODULE_ZTIMER
```

## tests/Kconfig
```kconfig
# Copyright (c) 2020 HAW Hamburg
#
# This file is subject to the terms and conditions of the GNU Lesser
# General Public License v2.1. See the file LICENSE in the top level
# directory for more details.
#
# TODO: Maybe this configurations should only be included for tests. How to detect?
menu "Tests"

config COMPONENT_test_utils_interactive_sync
    bool "Enable interactive sync for tests"

config COMPONENT_embunit
    bool "Embunit support"


endmenu
```

## tests/kconfig/Kconfig
```kconfig
menu "Application"

menuconfig KCONFIG_APP_MSG_1
    bool "Configure message 1"
    default y
    help
        "This will enable configuring the first message via Kconfig"

if KCONFIG_APP_MSG_1

config APP_MSG_1_TEXT
    string "Message 1 text"
    default "Message 1 defined in Kconfig file"

endif # KCONFIG_APP_MSG_1

menuconfig APP_MSG_2
    bool "Message 2"
    help
        "Activate printing the second message"

if APP_MSG_2

config APP_MSG_2_TEXT
    string "Second message to print"
    default "Default msg 2"

endif # APP_MSG_2

endmenu # Application
```
