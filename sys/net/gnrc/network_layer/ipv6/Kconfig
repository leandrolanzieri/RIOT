## sys/net/gnrc/network_layer/ipv6/Kconfig
```kconfig
# Copyright (c) 2020 HAW Hamburg
#
# This file is subject to the terms and conditions of the GNU Lesser
# General Public License v2.1. See the file LICENSE in the top level
# directory for more details.
#

menuconfig COMPONENT_gnrc_ipv6
    bool "Enable GNRC IPv6 support"
    depends on COMPONENT_evtimer
    depends on COMPONENT_gnrc_icmpv6
    depends on COMPONENT_gnrc_ipv6_nib
    depends on COMPONENT_gnrc_ndp
    depends on COMPONENT_gnrc_netif
    depends on GNRC_CORE
    select COMPONENT_gnrc_ipv6_hdr
    select HAS_SOCK_IPV6
    select HAS_IPV6

if COMPONENT_gnrc_ipv6

config GNRC_IPV6_MSG_QUEUE_SIZE
    int "Default message queue size to use for the IPv6 thread"
    default 8

endif # COMPONENT_gnrc_ipv6

config COMPONENT_gnrc_ipv6_hdr
    bool

config COMPONENT_gnrc_ipv6_nib
    bool "GNRC IPv6 Neighbour Information Base"
    default y
    depends on COMPONENT_luid
    depends on COMPONENT_l2util

config COMPONENT_gnrc_ndp
    bool "GNRC IPv6 Neighbour Discovery Protocol"
```

## sys/net/gnrc/network_layer/ipv6/blacklist/Kconfig
```kconfig
menuconfig KCONFIG_MODULE_GNRC_IPV6_BLACKLIST
    bool "Configure IPv6 blacklisting" if MODULE_GNRC_IPV6_BLACKLIST

if KCONFIG_MODULE_GNRC_IPV6_BLACKLIST

config GNRC_IPV6_BLACKLIST_SIZE
    int "Maximum size of the blacklist"
    default 8

endif # KCONFIG_MODULE_GNRC_IPV6_BLACKLIST
```

## sys/net/gnrc/network_layer/ipv6/nib/Kconfig
```kconfig
# Copyright (c) 2020 HAW Hamburg
#
# This file is subject to the terms and conditions of the GNU Lesser
# General Public License v2.1. See the file LICENSE in the top level
# directory for more details.
#
menuconfig KCONFIG_MODULE_GNRC_IPV6_NIB
    bool "Configure GNRC IPv6 NIB module"
    depends on MODULE_GNRC_IPV6_NIB
    help
        Configure GNRC IPv6 neighbor information base module using Kconfig.

if KCONFIG_MODULE_GNRC_IPV6_NIB

# when using this module DNS config options are not optional
config MODULE_GNRC_IPV6_NIB_DNS
    select GNRC_IPV6_NIB_CONF_DNS

# when using this module router features are not optional
config MODULE_GNRC_IPV6_NIB_ROUTER
    select GNRC_IPV6_NIB_CONF_ROUTER

config GNRC_IPV6_NIB_CONF_6LBR
    bool "6Lo border router features"
    default y if MODULE_GNRC_IPV6_NIB_6LBR

config GNRC_IPV6_NIB_CONF_6LR
    bool "6Lo router features"
    default y if MODULE_GNRC_IPV6_NIB_6LR
    default y if GNRC_IPV6_NIB_CONF_6LBR

config GNRC_IPV6_NIB_CONF_6LN
    bool "6Lo node features"
    default y if MODULE_GNRC_IPV6_NIB_6LN
    default y if GNRC_IPV6_NIB_CONF_6LR

config GNRC_IPV6_NIB_CONF_ROUTER
    bool "IPv6 router features"
    default y if GNRC_IPV6_NIB_CONF_6LR

config GNRC_IPV6_NIB_CONF_DNS
    bool "Support for DNS configuration options"
    help
        See [RFC 8106](https://tools.ietf.org/html/rfc8106)

config GNRC_IPV6_NIB_CONF_ADV_ROUTER
    bool "Router advertising at interface start-up"
    default y if GNRC_IPV6_NIB_CONF_ROUTER  && (!GNRC_IPV6_NIB_CONF_6LR || GNRC_IPV6_NIB_CONF_6LBR)

config GNRC_IPV6_NIB_CONF_SLAAC
    bool "Stateless address auto-configuration (SLAAC)"
    default y if MODULE_GNRC_IPV6_NIB_6LBR
    default n if MODULE_GNRC_IPV6_NIB_6LR
    default n if MODULE_GNRC_IPV6_NIB_6LN
    default y
    help
        Handle NDP messages according for stateless address auto-configuration
        (if activated on interface).
        See [RFC 4862](https://tools.ietf.org/html/rfc4862).

config GNRC_IPV6_NIB_NUMOF
    int "Number of entries in NIB"
    default 16 if MODULE_GNRC_IPV6_NIB_6LBR
    default 1 if MODULE_GNRC_IPV6_NIB_6LN && !GNRC_IPV6_NIB_CONF_6LR
    default 4
    help
        Keep in mind that this value has a direct influence on the maximum
        number of neighbors and duplicate address detection table entries.

config GNRC_IPV6_NIB_CONF_QUEUE_PKT
    bool "Queue packets for address resolution"
    default n if MODULE_GNRC_IPV6_NIB_6LN
    default n if GNRC_IPV6_NIB_CONF_6LN
    default y

config GNRC_IPV6_NIB_CONF_ARSM
    bool "NDP address resolution state-machine"
    default n if MODULE_GNRC_IPV6_NIB_6LN && !GNRC_IPV6_NIB_CONF_6LR
    default y

config GNRC_IPV6_NIB_CONF_REDIRECT
    bool "Handle Redirect Messages"

config GNRC_IPV6_NIB_CONF_DC
    bool "Destination cache"
    default y if GNRC_IPV6_NIB_CONF_REDIRECT

config GNRC_IPV6_NIB_CONF_MULTIHOP_P6C
    bool "Multihop prefix and 6LoWPAN context distribution"
    default y if GNRC_IPV6_NIB_CONF_6LR
    help
        See [RFC 6775, section 8.1](https://tools.ietf.org/html/rfc6775#section-8.1)

config GNRC_IPV6_NIB_CONF_MULTIHOP_DAD
    bool "Multihop duplicate address detection"
    help
        See [RFC 6775, section 8.2](https://tools.ietf.org/html/rfc6775#section-8.2)

config GNRC_IPV6_NIB_CONF_REACH_TIME_RESET
    int "Reset time for the reachability tie, in milliseconds"
    default 7200000
    help
        See [RFC 4861, section 6.3.4](https://tools.ietf.org/html/rfc4861#section-6.3.4)

config GNRC_IPV6_NIB_CONF_NO_RTR_SOL
    bool "Disable router solicitations"
    help
        Only do this if you know what you are doing.

config GNRC_IPV6_NIB_L2ADDR_MAX_LEN
    int "Maximum link-layer address length (aligned)"
    default 8

config GNRC_IPV6_NIB_DEFAULT_ROUTER_NUMOF
    int "Number of default routers in the default router list"
    default 1
    help
        This value has direct influence on the maximum number of default
        routers.

config GNRC_IPV6_NIB_OFFL_NUMOF
    int "Number of off-link entries in NIB"
    default 8
    help
        This value is equal to the maximum number of forwarding table and prefix
        list entries in NIB.

config GNRC_IPV6_NIB_ABR_NUMOF
    int "Number of authoritative border router entires in NIB"
    depends on GNRC_IPV6_NIB_CONF_MULTIHOP_P6C
    default 1

endif # KCONFIG_MODULE_GNRC_IPV6_NIB
```

## sys/net/gnrc/network_layer/ipv6/whitelist/Kconfig
```kconfig
menuconfig KCONFIG_MODULE_GNRC_IPV6_WHITELIST
    bool "Configure IPv6 whitelisting" if MODULE_GNRC_IPV6_WHITELIST

if KCONFIG_MODULE_GNRC_IPV6_WHITELIST

config GNRC_IPV6_WHITELIST_SIZE
    int "Maximum size of the whitelist"
    default 8

endif # KCONFIG_MODULE_GNRC_IPV6_WHITELIST
```

## sys/net/gnrc/network_layer/sixlowpan/Kconfig
```kconfig
menuconfig KCONFIG_MODULE_GNRC_SIXLOWPAN
    bool "Configure GNRC 6LoWPAN"
    depends on MODULE_GNRC_SIXLOWPAN
    help
        Enable to configure 6LoWPAN module of GNRC using Kconfig.

if KCONFIG_MODULE_GNRC_SIXLOWPAN

config GNRC_SIXLOWPAN_PRIO_DELTA
    int "Priority for the 6LoWPAN thread"
    default -4
    help
       Default priority level for the 6LoWPAN thread, referenced to the main
       thread priority. The lower this number is, the higher the priority.

config GNRC_SIXLOWPAN_MSG_QUEUE_SIZE
    int "Message queue size for the 6LoWPAN thread"
    default 8

if MODULE_GNRC_SIXLOWPAN_FRAG

config GNRC_SIXLOWPAN_MSG_FRAG_SIZE
    int "Number of datagrams that can be fragmented simultaneously"
    default 1
    help
        This determines the number of gnrc_sixlowpan_msg_frag_t instances
        available.

config GNRC_SIXLOWPAN_FRAG_RBUF_SIZE
    int "Size of the reassembly buffer"
    default 4

config GNRC_SIXLOWPAN_FRAG_RBUF_TIMEOUT_US
    int "Timeout for reassembly buffer entries"
    default 3000000
    help
        Timeout for reassemble buffer entries expressed in microseconds.

config GNRC_SIXLOWPAN_FRAG_RBUF_AGGRESSIVE_OVERRIDE
    bool "Aggressively ovverride reassembly buffer when full"
    default y
    help
        Setting this will cause the reassembly buffer to override the oldest
        entry no matter what. When not set, only the oldest entry that is older
        than GNRC_SIXLOWPAN_FRAG_RBUF_TIMEOUT_US will be overwritten (they will
        still timeout normally if reassembly buffer is not full).

endif # MODULE_GNRC_SIXLOWPAN_FRAG

config GNRC_SIXLOWPAN_ND_AR_LTIME
    int "Registration lifetime in minutes for the address registration option"
    default 15
    help
        This value should be adapted to the devices power-lifecycle so that it
        is greater than the time the device spends sleeping.
        See RFC 6775, section 5.8.1.

config GNRC_SIXLOWPAN_FRAG_VRB_SIZE
    int "Size of the virtual reassembly buffer"
    default 16 if MODULE_GNRC_SIXLOWPAN_FRAG_VRB
    default 0
    help
        See https://tools.ietf.org/html/draft-ietf-lwig-6lowpan-virtual-reassembly-01

config GNRC_SIXLOWPAN_FRAG_VRB_TIMEOUT_US
    int "Timeout for VRB entry in microseconds"
    default GNRC_SIXLOWPAN_FRAG_RBUF_TIMEOUT_US

endif # KCONFIG_MODULE_GNRC_SIXLOWPAN
```

## sys/net/gnrc/pktbuf/Kconfig
```kconfig
menuconfig COMPONENT_gnrc_pktbuf
    bool "GNRC Packet Buffer"
if COMPONENT_gnrc_pktbuf
    choice
        bool "GNRC Packet Buffer backend"
        config COMPONENT_gnrc_pktbuf_static
            bool "Static"
        config COMPONENT_gnrc_pktbuf_malloc
            bool "Malloc"
    endchoice
endif # COMPONENT_gnrc_pktbuf
```

## sys/net/gnrc/transport_layer/udp/Kconfig
```kconfig
menuconfig COMPONENT_gnrc_udp
    bool "Enable GNRC UDP support"
    depends on GNRC_CORE
    depends on COMPONENT_gnrc_ipv6
    select HAS_UDP
```

## sys/net/link_layer/eui_provider/Kconfig
```kconfig
# Copyright (c) 2020 HAW Hamburg
#
# This file is subject to the terms and conditions of the GNU Lesser
# General Public License v2.1. See the file LICENSE in the top level
# directory for more details.
#

config MODULE_EUI_PROVIDER
    bool "IEEE EUI-48/64 provider"
    select MODULE_LUID
    depends on TEST_KCONFIG
    default y if MODULE_NETDEV_DEFAULT
    help
        An EUI provider provides an Extended Unique Identifier, that is a
        hardware address for a network device.
```

## sys/net/link_layer/ieee802154/Kconfig
```kconfig
config COMPONENT_ieee802154
    bool "IEEE 802.15.4 support"
    default y if HAS_NETDEV_IEEE802154 && NETDEV_DEFAULT
    select HAS_IEEE802154

config HAS_IEEE802154
    bool
    help
        Indicates that there is IEEE 802.15.4 software support.
```

## sys/net/sock/Kconfig
```kconfig
# Copyright (c) 2019 HAW Hamburg
#
# This file is subject to the terms and conditions of the GNU Lesser
# General Public License v2.1. See the file LICENSE in the top level
# directory for more details.


menu "Sock"
menuconfig COMPONENT_sock_ip
    bool "Sock IP: Support for abstract IP endpoint"
    depends on HAS_SOCK_IP

if COMPONENT_sock_ip
    config COMPONENT_sock_ipv6
        bool "Enable IPv6 support"
        depends on HAS_SOCK_IPV6

    config COMPONENT_sock_ipv4
        bool "Enable IPv4 support"
        depends on HAS_SOCK_IPV4
endif

    config COMPONENT_sock_udp
        bool "Sock UDP: Support for abstract UDP endpoint"
        depends on HAS_SOCK_UDP

    config COMPONENT_sock_tcp
        bool "Sock TCP: Support for abstract TCP endpoint"
        depends on HAS_SOCK_TCP

    config COMPONENT_sock_dtls
        bool "Sock DTLS: Support for abstract DTLS endpoint"
        depends on HAS_SOCK_DTLS

menuconfig COMPONENT_sock_util
    bool "Configure SOCK utility functions"
    depends on MODULE_SOCK_UTIL

if COMPONENT_sock_util

config SOCK_SCHEME_MAXLEN
    int "Maximum length of the scheme part"
    default 16
    help
        This value is used in sock_urlsplit().

config SOCK_HOSTPORT_MAXLEN
    int "Maximum length of host:port part"
    default 64
    help
        This value is used in sock_urlsplit().

config SOCK_URLPATH_MAXLEN
    int "Maximum path length"
    default 64
    help
        This value is used in sock_urlsplit().

endif # COMPONENT_sock_util
endmenu # Sock
```

## sys/psa_crypto/psa_se_mgmt/Kconfig
```kconfig
# Copyright (c) 2022 HAW Hamburg
#
# This file is subject to the terms and conditions of the GNU Lesser
# General Public License v2.1. See the file LICENSE in the top level
# directory for more details.
#

menuconfig MODULE_PSA_SECURE_ELEMENT
    bool "PSA Secure Elements"
    select MODULE_PSA_KEY_SLOT_MGMT
    select MODULE_PSA_SE_MGMT

if MODULE_PSA_SECURE_ELEMENT

config MODULE_PSA_SECURE_ELEMENTS_MULTIPLE
    bool "Use multiple secure elements"

config PSA_MAX_SE_COUNT
    int
    prompt "Maximum number of secure elements" if MODULE_PSA_SECURE_ELEMENTS_MULTIPLE
    range 2 255 if MODULE_PSA_SECURE_ELEMENTS_MULTIPLE
    range 1 255

menuconfig MODULE_PSA_SECURE_ELEMENT_ATECCX08A
    bool "Microchip ATECCX08A"
    select PACKAGE_CRYPTOAUTHLIB
    depends on HAS_PERIPH_I2C
    help
        When using Cryptoauthlib as a backend for elliptic curve operations,
        please also choose the ECC symbol.

config MODULE_PSA_SECURE_ELEMENT_ATECCX08A_ECC
    bool "Microchip ATECCX08A Elliptic Curve P256"
    select PSA_KEY_SIZE_256
    select HAVE_PSA_SECURE_ELEMENT_ASYMMETRIC
    depends on MODULE_PSA_SECURE_ELEMENT_ATECCX08A

config MODULE_PSA_SE_MGMT
    bool

config HAVE_PSA_SECURE_ELEMENT_ASYMMETRIC
    bool
    help
        Indicates that an asymmetric operation is used with secure elements.

endif # MODULE_PSA_SECURE_ELEMENT
```

## sys/random/Kconfig
```kconfig
# Copyright (c) 2020 HAW Hamburg
#
# This file is subject to the terms and conditions of the GNU Lesser
# General Public License v2.1. See the file LICENSE in the top level
# directory for more details.
#

menuconfig MODULE_RANDOM
    bool "Random number generation"
    depends on TEST_KCONFIG

if MODULE_RANDOM

config MODULE_AUTO_INIT_RANDOM
    bool "Auto initialize the Random subsystem"
    depends on MODULE_AUTO_INIT
    default y

menuconfig MODULE_PRNG
    bool "Pseudo-random number generator API"
    default y
    help
        Access different pseudo-random number generators via the PRNG interface.

choice
    bool "Random API implementation"
    depends on MODULE_PRNG
    default MODULE_PRNG_HWRNG if HAS_PERIPH_HWRNG
    default MODULE_PRNG_TINYMT32

config MODULE_PRNG_TINYMT32
    bool "TinyMT32"
    select MODULE_TINYMT32
    help
        Tiny Mersenne Twister only 127 bit internal state.

config MODULE_PRNG_FORTUNA
    bool "Fortuna"
    depends on MODULE_HASHES
    depends on MODULE_CRYPTO_AES
    select MODULE_FORTUNA
    select MODULE_XTIMER

config MODULE_PRNG_HWRNG
    bool "Hardware random number generator"
    depends on HAS_PERIPH_HWRNG
    select MODULE_PERIPH_HWRNG
    select HAVE_CRYPTO_SECURE_PRNG

config MODULE_PRNG_MARSENNE
    bool "Marsenne"

config MODULE_PRNG_MINSTD
    bool "Minimal Standard"
    help
        Simple Park & Miller "minimal standard" PRNG.

config MODULE_PRNG_MUSL_LCG
    bool "Musl C library"

config MODULE_PRNG_SHA1PRNG
    bool "SHA-1"
    depends on MODULE_HASHES
    select HAVE_CRYPTO_SECURE_PRNG

config MODULE_PRNG_SHA256PRNG
    bool "SHA-256"
    depends on MODULE_HASHES
    select HAVE_CRYPTO_SECURE_PRNG

endchoice

config MODULE_PRNG_SHAXPRNG
    bool
    help
        Common code for SHA-1 and SHA-256 PRNG implementations.

rsource "fortuna/Kconfig"
rsource "tinymt32/Kconfig"

endif # MODULE_RANDOM

config HAVE_CRYPTO_SECURE_PRNG
    bool
    help
        Indicates that the current PRNG implementation is cryptographically
        secure.
```

## sys/random/tinymt32/Kconfig
```kconfig
# Copyright (c) 2020 HAW Hamburg
#
# This file is subject to the terms and conditions of the GNU Lesser
# General Public License v2.1. See the file LICENSE in the top level
# directory for more details.
#

config MODULE_TINYMT32
    bool "TinyMT32 pesudo-random number generator"
    depends on TEST_KCONFIG
    help
        Tiny Mersenne Twister only 127 bit internal state
```
