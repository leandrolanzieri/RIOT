## lwm2m_apps/c2c_observe/Kconfig
```kconfig
# Copyright (c) 2021 HAW Hamburg
#
# This file is subject to the terms and conditions of the GNU Lesser
# General Public License v2.1. See the file LICENSE in the top level
# directory for more details.
#

menu "Application configuration"

choice CLIENT_TYPE
    bool "Select the client type"

config CLIENT_TYPE_OBSERVER
    bool "Client 1 - Observer"

config CLIENT_TYPE_HOST
    bool "Client 2 - Host"

endchoice # CLIENT_TYPE

menu "Server configuration"

config LWM2M_SERVER_URI
    string "LwM2M Server URI to register/bootstrap with"
    default "coap://[fd00:dead:beef::1]"
    help
        The host part of the URI MUST be a valid IPv6 address.

config LWM2M_SERVER_SHORT_ID
    int "Server Short ID"
    default 1
    range 1 65534

config PSK_ID
    string "PSK Identity"
    default "Client_Identity"

config PSK_KEY
    string "PSK Key"
    default "ThisIsRIOT!"

config LWM2M_SERVER_IS_BOOTSTRAP
    bool "The server is a Bootstrap-Server"
    depends on LWM2M_BOOTSTRAP

endmenu # Server configuration

menu "Client configuration"

config LWM2M_CLIENT_URI
    string "LwM2M client URI to test C2C communication with"
    default "coap://[fd00:dead:beef::1]"
    help
        The host part of the URI MUST be a valid IPv6 address.

config LWM2M_CLIENT_SHORT_ID
    int "Client Short ID"
    default 5
    range 1 65534

config LWM2M_CLIENT_ENDPOINT
    string "Client Endpoint Name"
    default "testRIOTDevice"

choice
    bool "Security mode"

config LWM2M_CLIENT_SECURITY_NONE
    bool "None"

config LWM2M_CLIENT_SECURITY_PSK
    bool "Pre-Shared Keys"

endchoice

if LWM2M_CLIENT_SECURITY_PSK

config LWM2M_CLIENT_PSK_ID
    string "PSK Identity"
    default "C2C_Identity"

config LWM2M_CLIENT_PSK_KEY
    string "PSK Key"
    default "C2CRocks!"

endif # LWM2M_CLIENT_SECURITY_PSK

endmenu # Client configuration

menu "Light object configuration"

config LED_COLOR
    string "Color"
    default "Unknown"

config LED_APP_TYPE
    string "Application type"
    default "LED 0"

endmenu # Light object configuration

endmenu # Application configuration
```

## lwm2m_apps/cred_request_with_oscore/Kconfig
```kconfig
# Copyright (c) 2021 HAW Hamburg
#
# This file is subject to the terms and conditions of the GNU Lesser
# General Public License v2.1. See the file LICENSE in the top level
# directory for more details.
#

menu "Application configuration"

menu "Server configuration"

config LWM2M_SERVER_URI
    string "LwM2M Server URI to register/bootstrap with"
    default "coap://[fd00:dead:beef::1]"
    help
        The host part of the URI MUST be a valid IPv6 address.

config LWM2M_SERVER_SHORT_ID
    int "Server Short ID"
    default 1
    range 1 65534

config PSK_ID
    string "PSK Identity"
    default "Client_Identity"

config PSK_KEY
    string "PSK Key"
    default "ThisIsRIOT!"

config LWM2M_SERVER_IS_BOOTSTRAP
    bool "The server is a Bootstrap-Server"
    depends on LWM2M_BOOTSTRAP

endmenu

choice CLIENT_TYPE
    bool "Select the client type"

menuconfig CLIENT_TYPE_REQUESTER
    bool "Client 1 - Requester"

if CLIENT_TYPE_REQUESTER

config CLIENT_HOST_ENDPOINT
    string "Host client endpoint name"

config CLIENT_HOST_URI
    string "Host client URI"

config CLIENT_HOST_SHORT_ID
    int "Host Short Client ID"
    default 1

endif

config CLIENT_TYPE_HOST
    bool "Client 2 - Host"

endchoice # CLIENT_TYPE

endmenu # Application configuration
```

## pkg/cryptoauthlib/Kconfig
```kconfig
# Copyright (c) 2020 HAW Hamburg
#
# This file is subject to the terms and conditions of the GNU Lesser
# General Public License v2.1. See the file LICENSE in the top level
# directory for more details.
#

config PACK_CRYPTOAUTHLIB
    bool "Microchip CryptoAuth library"

choice CRYPTO_AES_IMPLEMENTATION

config MOD_CRYPTOAUTHLIB_CRYPTO_AES
    bool "Microchip CryptoAuth library"
    depends on PACK_CRYPTOAUTHLIB
    select MOD_CRYPTOAUTHLIB_CRYPTO

endchoice


choice CRYPTO_MODE_AES_CTR_IMPLEMENTATION

config MOD_CRYPTOAUTHLIB_CRYPTO_AES_CTR
    bool "Microchip CryptoAuth library"
    depends on PACK_CRYPTOAUTHLIB
    select MOD_CRYPTOAUTHLIB_CRYPTO

endchoice


choice CRYPTO_MODE_AES_CBC_IMPLEMENTATION

config MOD_CRYPTOAUTHLIB_CRYPTO_AES_CBC
    bool "Microchip CryptoAuth library"
    depends on PACK_CRYPTOAUTHLIB
    select MOD_CRYPTOAUTHLIB_CRYPTO

endchoice


choice CRYPTO_MODE_AES_ECB_IMPLEMENTATION

config MOD_CRYPTOAUTHLIB_CRYPTO_AES_ECB
    bool "Microchip CryptoAuth library"
    depends on PACK_CRYPTOAUTHLIB
    select MOD_CRYPTOAUTHLIB_CRYPTO

endchoice

config MOD_CRYPTOAUTHLIB_CRYPTO
    bool
    select HAVE_OWN_CIPHER_CONTEXT_T
    help
        Basic module containing crypto implementations using CryptoAuth.
```

## pkg/wakaama/contrib/objects/Kconfig.oscore
```kconfig
# Copyright (c) 2021 HAW Hamburg
#
# This file is subject to the terms and conditions of the GNU Lesser
# General Public License v2.1. See the file LICENSE in the top level
# directory for more details.
#

menu "OSCORE object"

config LWM2M_OSCORE_OBJ_BUF_SIZE
    int "Buffer size to store OSCORE credentials"
    default 16

config LWM2M_OBJ_OSCORE_INSTANCES_MAX
    int "Maximum number of instances of the OSCORE object"
    default 2

endmenu # OSCORE menu
```

## sys/Kconfig
```kconfig
# Copyright (c) 2019 HAW Hamburg
#
# This file is subject to the terms and conditions of the GNU Lesser
# General Public License v2.1. See the file LICENSE in the top level
# directory for more details.
#

config COMPONENT_pm_layered
    bool
    depends on COMPONENT_periph_pm

menu "System"

menu "Utils"
rsource "bitfield/Kconfig"
rsource "tsrb/Kconfig"
rsource "isrpipe/Kconfig"
rsource "fmt/Kconfig"
rsource "luid/Kconfig"
rsource "od/Kconfig"
rsource "iolist/Kconfig"
endmenu # Utils

menu "Crypto and hashes"
rsource "random/Kconfig"
rsource "hashes/Kconfig"
rsource "crypto/Kconfig"
endmenu # Crypto and hashes

rsource "usb/Kconfig"
rsource "shell/Kconfig"

menu "Event handlers"
rsource "evtimer/Kconfig"
endmenu # Event handlers

menuconfig COMPONENT_stdin
    bool "Enable and configure STDIN"
    default n

if COMPONENT_stdin
config COMPONENT_stdio_uart
    bool "Enable STDIO over UART"
    default y
    depends on COMPONENT_periph_uart

config COMPONENT_stdio_uart_rx
    bool "Enable STDIO over UART RX"
    default y
    depends on COMPONENT_stdio_uart
    depends on COMPONENT_isrpipe

endif # COMPONENT_stdin

menu "Boot configurations"

config COMPONENT_auto_init
    bool "Enable Auto Init"
    default y

endmenu # Boot configurations
endmenu # System
```

## sys/crypto/Kconfig
```kconfig
# Copyright (c) 2020 HAW Hamburg
#
# This file is subject to the terms and conditions of the GNU Lesser
# General Public License v2.1. See the file LICENSE in the top level
# directory for more details.
#

menu "Cryptography"

config MODULE_CRYPTO
    bool "General cryptography support"
    depends on TEST_KCONFIG
    help
        RIOT provides a collection of block cipher ciphers, different operation
        modes and cryptographic hash algorithms.

choice
    bool "Block cipher API"
    optional

menuconfig MODULE_CRYPTO_AES
    bool "AES-128"
    select MODULE_CRYPTO

if MODULE_CRYPTO_AES

config MODULE_CRYPTO_AES_PRECALCULATED
    bool "Use pre-calculated T-tables"
    help
        This improved speed at the expense of increased program size.
        The default is to calculate most tables on the fly.

config MODULE_CRYPTO_AES_UNROLL
    bool "Manually-unrolled loops"

endif # MODULE_CRYPTO_AES

config MODULE_CRYPTO_3DES
    bool "3DES"
    select MODULE_CRYPTO
    help
        This cipher is deprecated.

endchoice

comment "3DES is deprecated. Consider using AES-128"
    depends on MODULE_CRYPTO_3DES

rsource "modes/Kconfig"

endmenu # Cryptography
```

## sys/evtimer/Kconfig
```kconfig
menuconfig COMPONENT_evtimer
    bool "Use Event Timer"
    default n
    depends on COMPONENT_xtimer
```

## sys/hashes/Kconfig
```kconfig
# Copyright (c) 2020 HAW Hamburg
#
# This file is subject to the terms and conditions of the GNU Lesser
# General Public License v2.1. See the file LICENSE in the top level
# directory for more details.
#
menu "Hashes"
    depends on TEST_KCONFIG

menuconfig HASHES_SHA1
    bool "SHA-1 hashing support"

if HASHES_SHA1

choice
    bool "SHA-1 implementation"
    default MOD_PERIPH_HASH_SHA1

config MOD_PERIPH_HASH_SHA1
    bool "Hardware accelerated"
    depends on HAS_HW_HASH_SHA1

config MOD_HASHES_SHA1
    bool "Software implemented"
    select MOD_HASHES
    select MOD_HASHES_SHA2XX_COMMON

endchoice

endif # HASHES_SHA1

menuconfig HASHES_SHA256
    bool "SHA-256"

if HASHES_SHA256

choice
    bool "SHA-256 implementation"
    default MOD_PERIPH_HASH_SHA256

config MOD_PERIPH_HASH_SHA256
    bool "Hardware accelerated"
    depends on HAS_HW_HASH_SHA256

config MOD_HASHES_SHA256
    bool "Software"
    select MOD_HASHES
    select MOD_HASHES_SHA2XX_COMMON

endchoice

endif # HASHES_SHA256

config MOD_HASHES
    bool
    help
        Base module for software implemented hashes.

config MOD_HASHES_SHA2XX_COMMON
    bool
    help
        Base module for sha2xx implementations.

endmenu # Hashes
```

## sys/isrpipe/Kconfig
```kconfig
# Copyright (c) 2020 HAW Hamburg
#
# This file is subject to the terms and conditions of the GNU Lesser
# General Public License v2.1. See the file LICENSE in the top level
# directory for more details.

menuconfig COMPONENT_isrpipe
    bool "Enable ISR pipe"
    depends on COMPONENT_tsrb
```

## sys/net/Kconfig
```kconfig
# Copyright (c) 2019 HAW Hamburg
#
# This file is subject to the terms and conditions of the GNU Lesser
# General Public License v2.1. See the file LICENSE in the top level
# directory for more details.
#

config HAS_LORA
    bool

config HAS_ETHERNET
    bool

config HAS_IPV6
    bool

config HAS_UDP
    bool

config HAS_ICMPV6
    bool

config HAS_SOCK_IP
    bool

config HAS_SOCK_IPV6
    bool
    select HAS_SOCK_IP

config HAS_SOCK_IPV4
    bool
    select HAS_SOCK_IP

config HAS_SOCK_UDP
    bool

config HAS_SOCK_TCP
    bool

config HAS_SOCK_DTLS
    bool

menuconfig NETWORKING
    bool "Networking support"

if NETWORKING
    choice
        bool "Select network stack"
        config COMPONENT_gnrc
            bool "GNRC Network Stack"
        config COMPONENT_lwip
            bool "LWIP Stack"
        config COMPONENT_emb6
            bool "emb6 Stack"
        config COMPONENT_openthread
            bool "OpenThread Stack"
    endchoice

    rsource "sock/Kconfig"
    rsource "network_layer/icmpv6/Kconfig"
    rsource "transport_layer/udp/Kconfig"

menu "Net Utils"
    rsource "crosslayer/inet_csum/Kconfig"
    rsource "link_layer/l2util/Kconfig"
endmenu # Net Utils

if COMPONENT_gnrc
    rsource "gnrc/Kconfig"
endif # COMPONENT_gnrc

    rsource "netif/Kconfig"

config COMPONENT_ipv6_addr
    bool
    default y if HAS_IPV6

config COMPONENT_ipv6_hdr
    bool
    default y if HAS_IPV6

endif # NETWORKING
```

## sys/net/application_layer/Kconfig
```kconfig
menu "Application Layer"

rsource "gcoap/Kconfig"
rsource "nanocoap/Kconfig"

endmenu # Application Layer
```

## sys/net/application_layer/dynlink/Kconfig
```kconfig
# Copyright (c) 2020 HAW Hamburg
#
# This file is subject to the terms and conditions of the GNU Lesser
# General Public License v2.1. See the file LICENSE in the top level
# directory for more details.
#

menuconfig KCONFIG_MODULE_DYNLINK
    bool "Configure Dynlink"
    depends on MODULE_DYNLINK
    help
        Configure the Dynlink module using Kconfig. If not set, default values
        and CFLAGS will be used instead.

if KCONFIG_MODULE_DYNLINK

config DYNLINK_CLIF_ATTRS_MAX
    int "Maximum number of link format attributes to accept on a request"
    default 10

config DYNLINK_COND_MAX
    int "Maximum number of bindings to support"
    default 4

config DYNLINK_BIND_TABLE_PATH
    string "Binding table CoAP resource path"
    default "/bnd"

endif # KCONFIG_MODULE_DYNLINK
```

## sys/net/application_layer/gcoap/Kconfig
```kconfig
menuconfig KCONFIG_MODULE_GCOAP
    bool "Configure Gcoap" if MODULE_GCOAP
    help
        Enable this to configure Gcoap module using Kconfig. If not set default
        values and CFLAGS will be used.

if KCONFIG_MODULE_GCOAP

menu "Buffer Sizes"

config GCOAP_PDU_BUF_SIZE
    int "Request or response buffer size"
    default 128

config GCOAP_REQ_OPTIONS_BUF
    int "Request buffer reduction"
    default 4
    help
        Reduce payload length by this value for a request.
        Accommodates writing Content-Format option in gcoap_finish(). May be
        set to zero if the function is not used.

config GCOAP_RESP_OPTIONS_BUF
    int "Response buffer reduction"
    default 4
    help
        Reduce payload length by this value for a response.
        Accommodates writing Content-Format option in gcoap_finish(). May be
        set to zero if the function is not used.

config GCOAP_OBS_OPTIONS_BUF
    int "Size of observe notification options"
    default 4
    help
        Reduce payload length by this value for an observe notification.
        Accommodates writing Content-Format option in gcoap_finish(). May be
        set to zero if the function is not used.

endmenu # Buffer Sizes

menu "Observe options"

config GCOAP_OBS_CLIENTS_MAX
    int "Maximum number of Observe clients"
    default 2

config GCOAP_OBS_REGISTRATIONS_MAX
    int "Maximum number of registrations for Observable resources"
    default 2

config GCOAP_OBS_VALUE_WIDTH
    int "Width in bytes of the Observe option value for a notification"
    default 3
    help
        This width is used to determine the length of the 'tick' used to measure
        the time between observable changes to a resource. A tick is expressed
        internally as GCOAP_OBS_TICK_EXPONENT, which is the base 2 log value of
        the tick length in microseconds.

        The canonical setting for the value is 3 (exponent 5), which results in
        a tick length of 32 usec, per sec. 3.4, 4.4 of the RFC. Width 2
        (exponent 16) results in a tick length of ~64 msec, and width 1
        (exponent 24) results in a tick length of ~17 sec.

        The tick length must be short enough so that the Observe value strictly
        increases for each new notification. The purpose of the value is to
        allow a client to detect message reordering withing the network latency
        period (128 sec). For resources that change slowly, the reduced
        message length is useful when packet size is limited.

endmenu # Observe options

menu "Timeouts and retries"

config GCOAP_RECV_TIMEOUT
    int "Time in usec to wait for an incoming message"
    default 1000000

config GCOAP_NON_TIMEOUT
    int "Non-confirmable response timeout [usec]"
    default 5000000

config GCOAP_RESEND_BUFS_MAX
    int "PDU buffers available for resending confirmable messages"
    default 1

endmenu # Timeouts and retries

config GCOAP_MSG_QUEUE_SIZE
    int "Message queue size"
    default 4

config GCOAP_PORT
    int "Server port"
    default 5683

config GCOAP_REQ_WAITING_MAX
    int "Maximum amount of requests awaiting a response"
    default 2

# defined in gcoap.h as GCOAP_TOKENLEN_MAX
gcoap-tokenlen-max = 8

config GCOAP_TOKENLEN
    int "Length in bytes for a token"
    default 2
    range 0 $(gcoap-tokenlen-max)

endif # KCONFIG_MODULE_GCOAP
```
