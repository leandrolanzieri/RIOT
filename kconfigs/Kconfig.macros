## sys/net/application_layer/nanocoap/Kconfig
```kconfig
menuconfig KCONFIG_MODULE_NANOCOAP
    bool "Configure Nanocoap" if "$(module-nanocoap)" != ""
    help
        Enable this to configure Nanocoap module using Kconfig.

if KCONFIG_MODULE_NANOCOAP

config NANOCOAP_NOPTS_MAX
    int "Maximum number of options in a message"
    default 16

config NANOCOAP_URI_MAX
    int "Maximum length of URI"
    default 64
    help
        Maximum length of a resource path string read from or written to a
        message.

config NANOCOAP_BLOCK_SIZE_EXP_MAX
    int "Maximum size for blockwise transfer (power of 2)"
    default 6

config NANOCOAP_QS_MAX
    int "Maximum length of query string"
    depends on MODULE_GCOAP
    default 64

endif # KCONFIG_MODULE_NANOCOAP
```

## sys/net/gnrc/Kconfig
```kconfig
# Copyright (c) 2019 HAW Hamburg
#
# This file is subject to the terms and conditions of the GNU Lesser
# General Public License v2.1. See the file LICENSE in the top level
# directory for more details.
#

config GNRC_CORE
    bool
    default y
    depends on COMPONENT_gnrc_netreg
    depends on COMPONENT_gnrc_pkt
    depends on COMPONENT_gnrc_pktbuf
    depends on COMPONENT_gnrc_netapi

menu "Configure GNRC Network stack"

menu "GNRC Core"
config COMPONENT_gnrc_neterr
    bool "Enable GNRC error reports"

config COMPONENT_gnrc_pktdump
    bool "Enable GNRC pktdump"
    default y

config COMPONENT_gnrc_pkt
    bool "Enable GNRC pkt"
    default y

config COMPONENT_gnrc_netreg
    bool "Enable GNRC netreg"
    default y

rsource "netapi/Kconfig"
rsource "pktbuf/Kconfig"
endmenu # GNRC Core

rsource "link_layer/lorawan/Kconfig"
rsource "network_layer/ipv6/blacklist/Kconfig"
rsource "network_layer/ipv6/whitelist/Kconfig"
rsource "network_layer/ipv6/Kconfig"
rsource "netif/Kconfig"
rsource "network_layer/sixlowpan/Kconfig"
rsource "network_layer/icmpv6/Kconfig"
rsource "transport_layer/udp/Kconfig"


endmenu # GNRC Network Stack
```

## sys/net/gnrc/link_layer/lorawan/Kconfig
```kconfig
# Copyright (c) 2019 HAW Hamburg
#
# This file is subject to the terms and conditions of the GNU Lesser
# General Public License v2.1. See the file LICENSE in the top level
# directory for more details.

menuconfig COMPONENT_gnrc_lorawan
    bool "GNRC LoRaWAN support"
    depends on COMPONENT_xtimer
    depends on COMPONENT_random
    depends on COMPONENT_hashes
    depends on COMPONENT_crypto
    depends on COMPONENT_netdev_layer
    depends on COMPONENT_gnrc_neterr
    depends on COMPONENT_gnrc_netif
    depends on COMPONENT_fmt
    depends on COMPONENT_iolist
    depends on HAS_LORA
    help
        Use GNRC LoRaWAN.

if COMPONENT_gnrc_lorawan

config GNRC_LORAWAN_TIMER_DRIFT
    int "Maximum timer drift"
    default 10
    range -1000 1000
    help
        The value is expressed in per mille. This is only a workaround to
        compensate inaccurate timers. E.g. a value of 1 means there's a
        positive drift of 0.1% (set timeout to 1000 ms => triggers after
        1001 ms)

config GNRC_LORAWAN_MIN_SYMBOLS_TIMEOUT
    int "Minimum symbols to detect a LoRa preamble"
    default 30
    range 0 1024

endif # COMPONENT_gnrc_lorawan
```

## sys/net/gnrc/netif/Kconfig
```kconfig
# Copyright (c) 2020 HAW Hamburg
#
# This file is subject to the terms and conditions of the GNU Lesser
# General Public License v2.1. See the file LICENSE in the top level
# directory for more details.
#
menuconfig COMPONENT_gnrc_netif
    bool "Add support for GNRC network interface"
    help
        Configure GNRC network interface using Kconfig.
    depends on COMPONENT_netif
    depends on GNRC_CORE
    depends on COMPONENT_l2util

if COMPONENT_gnrc_netif

config COMPONENT_gnrc_netif_hdr
    bool
    default y

config COMPONENT_auto_init_gnrc_netif
    bool "Auto initialized GNRC netif"
    default y
    depends on COMPONENT_auto_init

config COMPONENT_gnrc_netif_ethernet
    bool
    default y if HAS_ETHERNET

config COMPONENT_gnrc_netif_lorawan
    bool
    default y if HAS_LORA

config COMPONENT_gnrc_netif_ieee802154
    bool
    default y if HAS_IEEE802154
    depends on COMPONENT_ieee802154
 
config GNRC_NETIF_MSG_QUEUE_SIZE
    int "Message queue size for network interface threads"
    default 16

config GNRC_NETIF_IPV6_ADDRS_NUMOF
    int "Maximum number of unicast and anycast addresses per interface"
    default 2
    help
        If you change this, please make sure that
        @ref CONFIG_GNRC_NETIF_IPV6_GROUPS_NUMOF is also large enough to fit the
        addresses' solicited nodes multicast addresses.
        Default: 2 (1 link-local + 1 global address).

config GNRC_NETIF_DEFAULT_HL
    int "Default hop limit"
    default 64

config GNRC_NETIF_MIN_WAIT_AFTER_SEND_US
    int "Minimum wait time after a send operation"
    default 0
    help
        This value is expressed in microseconds. It is purely meant as a debugging
        feature to slow down a radios sending.

endif # COMPONENT_gnrc_netif
rsource "lorawan/Kconfig"
```

## sys/net/gnrc/netif/lorawan/Kconfig
```kconfig
# Copyright (c) 2020 HAW Hamburg
#
# This file is subject to the terms and conditions of the GNU Lesser
# General Public License v2.1. See the file LICENSE in the top level
# directory for more details.

config COMPONENT_gnrc_netif_lorawan
    bool "Enable GNRC LoRaWAN netif interface"
    depends on COMPONENT_gnrc_lorawan
    depends on COMPONENT_gnrc_netif
```

## sys/net/gnrc/network_layer/icmpv6/Kconfig
```kconfig
menuconfig COMPONENT_gnrc_icmpv6
    bool "Use GNRC ICMPv6"
    depends on GNRC_CORE
    depends on COMPONENT_inet_csum
    select HAS_ICMPV6
```
