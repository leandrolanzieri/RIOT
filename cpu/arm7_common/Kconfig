## cpu/arm7_common/Kconfig
```kconfig
# Copyright (c) 2020 HAW Hamburg
#
# This file is subject to the terms and conditions of the GNU Lesser
# General Public License v2.1. See the file LICENSE in the top level
# directory for more details.

config CPU_ARM7_COMMON
    select HAS_arch_32bit
    select HAS_arch_arm
    select HAS_arch_arm7
    select HAS_cpp
    select HAS_periph_pm
    select HAS_puf_sram
```

## cpu/atmega128rfa1/Kconfig
```kconfig
# Copyright (c) 2020 HAW Hamburg
#
# This file is subject to the terms and conditions of the GNU Lesser
# General Public License v2.1. See the file LICENSE in the top level
# directory for more details.

config CPU_ATMEGA128RFA1
    select HAS_atmega_pcint1
```

## cpu/atmega2560/Kconfig
```kconfig
# Copyright (c) 2020 HAW Hamburg
#
# This file is subject to the terms and conditions of the GNU Lesser
# General Public License v2.1. See the file LICENSE in the top level
# directory for more details.

config CPU_ATMEGA2560
    select HAS_atmega_pcint1
    select HAS_atmega_pcint2
    select CPU_ATMEGA_COMMON
```

## cpu/atmega256rfr2/Kconfig
```kconfig
# Copyright (c) 2020 HAW Hamburg
#
# This file is subject to the terms and conditions of the GNU Lesser
# General Public License v2.1. See the file LICENSE in the top level
# directory for more details.

config CPU_ATMEGA256RFR2
    bool
    default y
    select HAS_atmega_pcint1
    select CPU_ATMEGA_COMMON
```

## cpu/atmega_common/Kconfig
```kconfig
# Copyright (c) 2020 HAW Hamburg
#
# This file is subject to the terms and conditions of the GNU Lesser
# General Public License v2.1. See the file LICENSE in the top level
# directory for more details.

config CPU_ATMEGA_COMMON
    select HAS_arch_8bit
    select HAS_arch_avr8
    select HAS_atmega_pcint0
    select HAS_periph_eeprom
    select HAS_periph_gpio
    select HAS_periph_gpio_irq
    select HAS_periph_pm
    select HAS_periph_cpuid
    select HAS_periph_wdt
```

## cpu/cc13x2/Kconfig
```kconfig
# Copyright (c) 2020 HAW Hamburg
#
# This file is subject to the terms and conditions of the GNU Lesser
# General Public License v2.1. See the file LICENSE in the top level
# directory for more details.

config CPU_CC13X2
    bool
    default y
    select CPU_CORTEXM_COMMON

source "$(RIOTCPU)/cortexm_common/Kconfig"
```

## cpu/cc2538/Kconfig
```kconfig
# Copyright (c) 2020 HAW Hamburg
#
# This file is subject to the terms and conditions of the GNU Lesser
# General Public License v2.1. See the file LICENSE in the top level
# directory for more details.

config CPU_CC2538
    bool
    default y
    select HAS_periph_cpuid
    select HAS_periph_gpio
    select HAS_periph_gpio_irq
    select HAS_periph_hwrng
    select HAS_periph_uart_modecfg
    select HAS_puf_sram
    select CPU_CORTEXM_COMMON
```

## cpu/cc2538/radio/Kconfig
```kconfig
# Copyright (c) 2021 HAW Hamburg
#
# This file is subject to the terms and conditions of the GNU Lesser
# General Public License v2.1. See the file LICENSE in the top level
# directory for more details.
#

menuconfig MODULE_CC2538_RF
    bool "CC2538 IEEE 802.15.4 radio" if !MODULE_NETDEV_DEFAULT
    depends on TEST_KCONFIG
    depends on CPU_FAM_CC2538
    default MODULE_NETDEV_DEFAULT
    select MODULE_NETDEV_IEEE802154_SUBMAC if MODULE_NETDEV && !MODULE_CC2538_RF_NETDEV_LEGACY

if MODULE_CC2538_RF

config MODULE_CC2538_RF_OBS_SIG
    bool "Output observation signals"
    help
    Say y to output different observation signals from the RF Core to GPIO pins.
    These signals can be useful for debugging of low-level protocols or control
    of external PA, LNA, or switches.

    For more information check section 9.2.4 of the CC2538 User's Manual.

config MODULE_CC2538_RF_NETDEV_LEGACY
    bool "Use legacy netdev-based driver implementation"
    select MODULE_NETDEV_IEEE802154

endif # MODULE_CC2538_RF
```

## cpu/cc26xx_cc13xx/Kconfig
```kconfig
# Copyright (c) 2020 HAW Hamburg
#
# This file is subject to the terms and conditions of the GNU Lesser
# General Public License v2.1. See the file LICENSE in the top level
# directory for more details.

config CPU_CC26XX_CC13XX
    select HAS_periph_cpuid
    select HAS_periph_uart
    select HAS_periph_uart_modecfg
    select CPU_CORTEXM_COMMON
```

## cpu/cortexm_common/Kconfig
```kconfig
# Copyright (c) 2020 HAW Hamburg
#
# This file is subject to the terms and conditions of the GNU Lesser
# General Public License v2.1. See the file LICENSE in the top level
# directory for more details.

config COMPONENT_cortexm_common
    bool

config COMPONENT_cortexm_common_periph
    bool

config CPU_CORTEXM_COMMON
    bool
    default y
    select HAS_arch_32bit
    select HAS_arch_arm
    select HAS_arch_cortexm
    select HAS_periph_pm
    select HAS_cpp
    select HAS_cpu_check_address
    select COMPONENT_periph
    select COMPONENT_cortexm_common
    select COMPONENT_cortexm_common_periph
    select COMPONENT_newlib
    select COMPONENT_newlib_nano
    select COMPONENT_newlib_syscalls_default
```

## cpu/efm32/Kconfig
```kconfig
# Copyright (c) 2020 HAW Hamburg
#
# This file is subject to the terms and conditions of the GNU Lesser
# General Public License v2.1. See the file LICENSE in the top level
# directory for more details.

config CPU_EFM32
    bool
    default y
    select HAS_arch_efm32
    select HAS_periph_cpuid
    select HAS_periph_flashpage
    select HAS_periph_flashpage_raw
    select HAS_periph_gpio
    select HAS_periph_gpio_irq
    select HAS_periph_hwrng
    select HAS_HW_AES
    select HAS_HW_HASH_SHA1
    select HAS_HW_HASH_SHA256 
    select CPU_CORTEXM_COMMON

# define specific CPU models
config CPU_EFM32_PG12B
    bool
    select CPU_EFM32
    select COMPONENT_cpu_efm32pg12b
    select COMPONENT_gecko_sdk
    select COMPONENT_gecko_sdk_emlib
    select COMPONENT_gecko_sdk_emlib_extra

# SDK components
config COMPONENT_gecko_sdk
    bool

config COMPONENT_gecko_sdk_emlib
    bool

config COMPONENT_gecko_sdk_emlib_extra
    bool

rsource "families/Kconfig"
source "$(RIOTCPU)/cortexm_common/Kconfig"
```

## cpu/esp32/Kconfig
```kconfig
# Copyright (c) 2020 HAW Hamburg
#
# This file is subject to the terms and conditions of the GNU Lesser
# General Public License v2.1. See the file LICENSE in the top level
# directory for more details.

config CPU_ESP32
    select HAS_arch_32bit
    select HAS_arch_esp32
    select HAS_cpp
    select HAS_periph_cpuid
    select HAS_periph_hwrng
    select HAS_periph_pm
    select HAS_periph_rtc
    select HAS_periph_timer
```

## cpu/esp8266/Kconfig
```kconfig
# Thread stack sizes defaults
config THREAD_STACKSIZE_DEFAULT
    default 1024

config THREAD_EXTRA_STACKSIZE_PRINTF
    default 0

# By default THREAD_STACKSIZE_DEFAULT + THREAD_EXTRA_STACKSIZE_PRINTF
config THREAD_STACKSIZE_MAIN
    default 1024

config THREAD_STACKSIZE_IDLE
    default 1024
```

## cpu/ezr32wg/Kconfig
```kconfig
# Copyright (c) 2020 HAW Hamburg
#
# This file is subject to the terms and conditions of the GNU Lesser
# General Public License v2.1. See the file LICENSE in the top level
# directory for more details.

config CPU_EZR32WG
    select HAS_periph_cpuid
    select HAS_periph_gpio
    select HAS_periph_gpio_irq
    select CPU_CORTEXM_COMMON
```

## cpu/fe310/Kconfig
```kconfig
# Copyright (c) 2020 HAW Hamburg
#
# This file is subject to the terms and conditions of the GNU Lesser
# General Public License v2.1. See the file LICENSE in the top level
# directory for more details.

config CPU_FE310
    bool
    default y
    select HAS_arch_32bit
    select HAS_arch_riscv
    select HAS_cpp
    select HAS_periph_cpuid
    select HAS_periph_gpio
    select HAS_periph_gpio_irq
    select HAS_periph_pm
```

## cpu/lpc2387/Kconfig
```kconfig
# Copyright (c) 2020 HAW Hamburg
#
# This file is subject to the terms and conditions of the GNU Lesser
# General Public License v2.1. See the file LICENSE in the top level
# directory for more details.

config CPU_LPC2387
    bool
    default y
    select HAS_backup_ram
    select HAS_periph_dac
    select HAS_periph_gpio
    select HAS_periph_gpio_irq
    select CPU_ARM7_COMMON
```

## cpu/mips32r2_common/Kconfig
```kconfig
# Copyright (c) 2020 HAW Hamburg
#
# This file is subject to the terms and conditions of the GNU Lesser
# General Public License v2.1. See the file LICENSE in the top level
# directory for more details.

config CPU_MIPS32R2_COMMON
    bool
    default y
    select HAS_arch_32bit
    select HAS_arch_mips32r2
    select HAS_cpp
    select HAS_periph_pm
```

## cpu/mips32r2_generic/Kconfig
```kconfig
# Thread stack sizes defaults
config THREAD_STACKSIZE_DEFAULT
    default 2048

config THREAD_EXTRA_STACKSIZE_PRINTF
    default 1024

# By default THREAD_STACKSIZE_DEFAULT + THREAD_EXTRA_STACKSIZE_PRINTF
config THREAD_STACKSIZE_MAIN
    default 3072

config THREAD_STACKSIZE_IDLE
    default 1536
```

## cpu/mips_pic32_common/Kconfig
```kconfig
# Copyright (c) 2020 HAW Hamburg
#
# This file is subject to the terms and conditions of the GNU Lesser
# General Public License v2.1. See the file LICENSE in the top level
# directory for more details.

config CPU_MIPS_PIC32_COMMON
    bool
    default y
    select HAS_periph_cpuid
    select CPU_MIPS32R2_COMMON

source "$(RIOTCPU)/mips32r2_common/Kconfig"
```

## cpu/mips_pic32mz/Kconfig
```kconfig
# Copyright (c) 2020 HAW Hamburg
#
# This file is subject to the terms and conditions of the GNU Lesser
# General Public License v2.1. See the file LICENSE in the top level
# directory for more details.

config CPU_MIPS_PIC32MZ
    bool
    default y
    select HAS_periph_hwrng
    select CPU_MIPS_PIC32_COMMON

source "$(RIOTCPU)/mips_pic32_common/Kconfig"
```

## cpu/msp430_common/Kconfig
```kconfig
# Copyright (c) 2020 HAW Hamburg
#
# This file is subject to the terms and conditions of the GNU Lesser
# General Public License v2.1. See the file LICENSE in the top level
# directory for more details.

config CPU_MSP430_COMMON
    bool
    default y
    select HAS_arch_16bit
    select HAS_arch_msp430
    select HAS_periph_flashpage
    select HAS_periph_flashpage_raw
    select HAS_periph_pm
```

## cpu/native/Kconfig
```kconfig
# Copyright (c) 2020 HAW Hamburg
#
# This file is subject to the terms and conditions of the GNU Lesser
# General Public License v2.1. See the file LICENSE in the top level
# directory for more details.

config COMPONENT_native_drivers
    bool
    default y if CPU_NATIVE

config COMPONENT_stdio_native
    bool
    default y if CPU_NATIVE

config CPU_NATIVE
    bool
    default y
    select HAS_arch_32bit
    select HAS_arch_native
    select HAS_cpp
    select HAS_periph_cpuid
    select HAS_periph_hwrng
    select HAS_periph_pm
    select HAS_periph_pwm
    select HAS_netdev_tap
    #select HAS_periph_spi
```

## cpu/native/Kconfig.bak
```kconfig
config CPU_NATIVE
    bool
    default y

    select COMPONENT_native_drivers
    select COMPONENT_stdio_native
    select HAS_periph
    select HAS_periph_common
    select HAS_periph_gpio
    select HAS_periph_uart
    select HAS_periph_pm
```
