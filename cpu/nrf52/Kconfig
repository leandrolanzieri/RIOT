## cpu/nrf52/Kconfig
```kconfig
# Copyright (c) 2020 HAW Hamburg
#
# This file is subject to the terms and conditions of the GNU Lesser
# General Public License v2.1. See the file LICENSE in the top level
# directory for more details.

config CPU_NRF52
    bool
    default y
    select HAS_periph_adc
    select HAS_ble_nimble_netif
    select CPU_NRF5X_COMMON

source "$(RIOTCPU)/nrf5x_common/Kconfig"
```

## cpu/nrf5x_common/Kconfig
```kconfig
# Copyright (c) 2020 HAW Hamburg
#
# This file is subject to the terms and conditions of the GNU Lesser
# General Public License v2.1. See the file LICENSE in the top level
# directory for more details.

config CPU_NRF5X_COMMON
    bool
    default y
    select HAS_periph_cpuid
    select HAS_periph_flashpage
    select HAS_periph_flashpage_raw
    select HAS_periph_gpio
    select HAS_periph_gpio_irq
    select HAS_periph_hwrng
    select HAS_periph_temperature
    select HAS_periph_uart_modecfg
    select HAS_periph_wdt
    select HAS_periph_wdt_cb
    select HAS_ble_nimble
    select HAS_radio_nrfble
    select HAS_radio_nrfmin
    select HAS_puf_sram

config COMPONENT_nrf5x_common_periph
    bool
    default y

config COMPONENT_cpu_common
    bool
    default y

source "$(RIOTCPU)/cortexm_common/Kconfig"
```

## cpu/sam0_common/Kconfig
```kconfig
# Copyright (c) 2020 HAW Hamburg
#
# This file is subject to the terms and conditions of the GNU Lesser
# General Public License v2.1. See the file LICENSE in the top level
# directory for more details.

config CPU_SAM0_COMMON
    bool
    default y
    select HAS_periph_cpuid
    select HAS_periph_flashpage
    select HAS_periph_flashpage_raw
    select HAS_periph_flashpage_rwee
    select HAS_periph_gpio
    select HAS_periph_gpio_irq
    select HAS_periph_uart_modecfg
    select HAS_periph_uart_nonblocking
    select HAS_periph_wdt
    select HAS_periph_wdt_cb
    select COMPONENT_sam0_common_periph

rsource "periph/Kconfig"
```

## cpu/saml21/Kconfig
```kconfig
# Copyright (c) 2020 HAW Hamburg
#
# This file is subject to the terms and conditions of the GNU Lesser
# General Public License v2.1. See the file LICENSE in the top level
# directory for more details.

config CPU_SAML21
    select HAS_backup_ram
    select HAS_periph_hwrng
    select CPU_SAM0_COMMON
```

## cpu/stm32_common/Kconfig
```kconfig
# Copyright (c) 2020 HAW Hamburg
#
# This file is subject to the terms and conditions of the GNU Lesser
# General Public License v2.1. See the file LICENSE in the top level
# directory for more details.

config COMPONENT_stm32_common
    bool

config COMPONENT_stm32_common_periph
    bool

config COMPONENT_pm_layered
    default y if CPU_STM32_COMMON

config COMPONENT_periph_uart
    depends on COMPONENT_pm_layered

config CPU_STM32_COMMON
    bool
    select HAS_periph_cpuid
    select HAS_periph_gpio
    select HAS_periph_gpio_irq
    select HAS_puf_sram
    select HAS_periph_uart_modecfg
    select HAS_periph_wdt
    select COMPONENT_stm32_common
    select COMPONENT_stm32_common_periph
    select CPU_CORTEXM_COMMON
```

## cpu/stm32f3/Kconfig
```kconfig
# Copyright (c) 2020 HAW Hamburg
#
# This file is subject to the terms and conditions of the GNU Lesser
# General Public License v2.1. See the file LICENSE in the top level
# directory for more details.

config CPU_STM32F3
    bool
    default y
    select HAS_periph_flashpage
    select HAS_periph_flashpage_raw
    select CPU_STM32_COMMON
```

## cpu/stm32l0/Kconfig.bak
```kconfig
# Copyright (c) 2020 HAW Hamburg
#
# This file is subject to the terms and conditions of the GNU Lesser
# General Public License v2.1. See the file LICENSE in the top level
# directory for more details.
#
config CPU_STM32L0
    bool
    default y 
    select COMPONENT_cortexm_common
    select COMPONENT_cortexm_common_periph
    select COMPONENT_periph
    select COMPONENT_newlib
    select COMPONENT_newlib_nano
    select COMPONENT_newlib_syscalls_default
    select COMPONENT_stm32_common
    select COMPONENT_stm32_common_periph
```

## drivers/Kconfig
```kconfig
# Copyright (c) 2020 HAW Hamburg
#
# This file is subject to the terms and conditions of the GNU Lesser
# General Public License v2.1. See the file LICENSE in the top level
# directory for more details.

menu "Drivers"

menu "Actuator devices"

rsource "apa102/Kconfig"
rsource "dsp0401/Kconfig"
rsource "dynamixel/Kconfig"
rsource "feetech/Kconfig"
rsource "grove_ledbar/Kconfig"
rsource "hd44780/Kconfig"
rsource "lpd8808/Kconfig"
rsource "motor_driver/Kconfig"
rsource "my9221/Kconfig"
rsource "pca9685/Kconfig"
rsource "pcd8544/Kconfig"
rsource "rgbled/Kconfig"
rsource "servo/Kconfig"
rsource "uart_half_duplex/Kconfig"
rsource "ws281x/Kconfig"

endmenu # Actuator devices


menu "Network devices"

menu "Netdev interfaces"

rsource "netdev_ieee802154/Kconfig"
rsource "netdev_eth/Kconfig"
rsource "netdev_layer/Kconfig"

config COMPONENT_netdev_tap
    bool "Netdev TAP device"
    default y if DEFAULT_NETDEV && HAS_netdev_tap
    select COMPONENT_netdev_eth

endmenu # Netdev interface

menu "CAN devices"

rsource "can_trx/Kconfig"
rsource "ncv7356/Kconfig"
rsource "tja1042/Kconfig"

endmenu # CAN devices

rsource "at86rf2xx/Kconfig"
rsource "ata8520e/Kconfig"
rsource "cc110x/Kconfig"
rsource "cc2420/Kconfig"
rsource "dose/Kconfig"
rsource "enc28j60/Kconfig"
rsource "encx24j600/Kconfig"
rsource "ethos/Kconfig"
rsource "kw2xrf/Kconfig"
rsource "mrf24j40/Kconfig"
rsource "pn532/Kconfig"
rsource "rn2xx3/Kconfig"
rsource "slipdev/Kconfig"
rsource "stm32_eth/Kconfig"
rsource "sx127x/Kconfig"
rsource "w5100/Kconfig"
rsource "xbee/Kconfig"

endmenu # Network devices


menu "Peripheral drivers"

rsource "periph_common/Kconfig"

endmenu # Peripheral drivers


menu "Power supply devices"

rsource "tps6274x/Kconfig"

endmenu # Power supply devices


menu "Sensor devices"

rsource "ad7746/Kconfig"
rsource "adcxx1c/Kconfig"
rsource "ads101x/Kconfig"
rsource "adt7310/Kconfig"
rsource "adxl345/Kconfig"
rsource "at30tse75x/Kconfig"
rsource "bh1750fvi/Kconfig"
rsource "bmp180/Kconfig"
rsource "bmx055/Kconfig"
rsource "bmx280/Kconfig"
rsource "ccs811/Kconfig"
rsource "dcf77/Kconfig"
rsource "dht/Kconfig"
rsource "ds1307/Kconfig"
rsource "ds18/Kconfig"
rsource "ds3234/Kconfig"
rsource "ds75lx/Kconfig"
rsource "fxos8700/Kconfig"
rsource "hdc1000/Kconfig"
rsource "hih6130/Kconfig"
rsource "hts221/Kconfig"
rsource "ina2xx/Kconfig"
rsource "ina3221/Kconfig"
rsource "io1_xplained/Kconfig"
rsource "isl29020/Kconfig"
rsource "isl29125/Kconfig"
rsource "itg320x/Kconfig"
rsource "jc42/Kconfig"
rsource "l3g4200d/Kconfig"
rsource "lc709203f/Kconfig"
rsource "lis2dh12/Kconfig"
rsource "lis3dh/Kconfig"
rsource "lis3mdl/Kconfig"
rsource "lpsxxx/Kconfig"
rsource "lsm303dlhc/Kconfig"
rsource "lsm6dsl/Kconfig"
rsource "ltc4150/Kconfig"
rsource "mag3110/Kconfig"
rsource "mma7660/Kconfig"
rsource "mma8x5x/Kconfig"
rsource "mpl3115a2/Kconfig"
rsource "mpu9x50/Kconfig"
rsource "mq3/Kconfig"
rsource "opt3001/Kconfig"
rsource "ph_oem/Kconfig"
rsource "pir/Kconfig"
rsource "pulse_counter/Kconfig"
rsource "qmc5883l/Kconfig"
rsource "sds011/Kconfig"
rsource "sht1x/Kconfig"
rsource "sht2x/Kconfig"
rsource "sht3x/Kconfig"
rsource "shtc1/Kconfig"
rsource "srf02/Kconfig"
rsource "srf04/Kconfig"
rsource "srf08/Kconfig"
rsource "si114x/Kconfig"
rsource "si70xx/Kconfig"
rsource "tcs37727/Kconfig"
rsource "tmp00x/Kconfig"
rsource "tsl2561/Kconfig"
rsource "tsl4531x/Kconfig"
rsource "vcnl40x0/Kconfig"
rsource "veml6070/Kconfig"

endmenu # Sensor devices


menu "Soft Peripheral interface"

rsource "soft_spi/Kconfig"

endmenu # Soft Peripheral interface


menu "Storage devices"

rsource "mtd/Kconfig"
rsource "mtd_flashpage/Kconfig"
rsource "mtd_sdcard/Kconfig"
rsource "mtd_spi_nor/Kconfig"
rsource "nvram/Kconfig"
rsource "sdcard_spi/Kconfig"

endmenu # Storage devices

menu "Others"

rsource "at/Kconfig"
rsource "ili9341/Kconfig"

endmenu # Others

endmenu # Drivers
```

## drivers/ad7746/Kconfig
```kconfig
# Copyright (c) 2020 HAW Hamburg
#
# This file is subject to the terms and conditions of the GNU Lesser
# General Public License v2.1. See the file LICENSE in the top level
# directory for more details.

config HAS_ad7746
    bool

menuconfig COMPONENT_ad7746
    bool "AD7746 Capacitance-to-digital converter driver"
    default y if HAS_ad7746 && SAUL_DEFAULT
```

## drivers/adcxx1c/Kconfig
```kconfig
# Copyright (c) 2020 HAW Hamburg
#
# This file is subject to the terms and conditions of the GNU Lesser
# General Public License v2.1. See the file LICENSE in the top level
# directory for more details.

config HAS_adcxx1c
    bool

menuconfig COMPONENT_adcxx1c
    bool "ADCXX1C ADC device driver"
    default y if HAS_adcxx1c && SAUL_DEFAULT
```

## drivers/ads101x/Kconfig
```kconfig
# Copyright (c) 2020 HAW Hamburg
#
# This file is subject to the terms and conditions of the GNU Lesser
# General Public License v2.1. See the file LICENSE in the top level
# directory for more details.

config HAS_ads101x
    bool

menuconfig COMPONENT_ads101x
    bool "ADS101x/111x ADC device driver"
    default y if HAS_ads101x && SAUL_DEFAULT
```

## drivers/at30tse75x/Kconfig
```kconfig
# Copyright (c) 2020 HAW Hamburg
#
# This file is subject to the terms and conditions of the GNU Lesser
# General Public License v2.1. See the file LICENSE in the top level
# directory for more details.

config HAS_at30tse75x
    bool

menuconfig COMPONENT_at30tse75x
    bool "AT30TSE75x temperature sensor with EEPROM"
    default y if HAS_at30tse75x
```
