## drivers/at86rf215/Kconfig
```kconfig
# Copyright (c) 2020 Freie Universitaet Berlin
#               2020 HAW Hamburg
#
# This file is subject to the terms and conditions of the GNU Lesser
# General Public License v2.1. See the file LICENSE in the top level
# directory for more details.
#

menuconfig MODULE_AT86RF215
    bool "AT86RF215 IEEE 802.15.4 compatible radio"
    depends on HAS_PERIPH_GPIO
    depends on HAS_PERIPH_GPIO_IRQ
    depends on HAS_PERIPH_SPI
    depends on MODULE_NETDEV_IEEE802154
    depends on TEST_KCONFIG
    select MODULE_PERIPH_GPIO
    select MODULE_PERIPH_GPIO
    select MODULE_PERIPH_SPI
    select MODULE_XTIMER
    select MODULE_IEEE802154
# select radio features
    select HAVE_NETDEV_IEEE802154_OQPSK
    select HAVE_NETDEV_IEEE802154_MR_OQPSK
    select HAVE_NETDEV_IEEE802154_MR_OFDM
    select HAVE_NETDEV_IEEE802154_MR_FSK
    select HAVE_NETDEV_IEEE802154_MULTIMODE

if MODULE_AT86RF215

choice
    bool "Device model"
    default MODULE_AT86RF215IQ if HAVE_AT86RF215IQ
    default MODULE_AT86RF215M if HAVE_AT86RF215M
    default AT86RF215

config AT86RF215
    bool "AT86RF215"

config MODULE_AT86RF215IQ
    bool "AT86RF215IQ"

config MODULE_AT86RF215M
    bool "AT86RF215M"
    select MODULE_AT86RF215_SUBGHZ

endchoice

config MODULE_AT86RF215_SUBGHZ
    bool "Support Sub GHz band"

config MODULE_AT86RF215_24GHZ
    bool "Support 2.4 GHz band"
    default y if MODULE_AT86RF215_SUBGHZ

config MODULE_AUTO_INIT_AT86RF215
    bool "Auto initialize AT86RF215 driver"
    depends on MODULE_AUTO_INIT
    default y

endif # MODULE_AT86RF215

# features to indicate that the hardware is present
config HAVE_AT86RF215
    bool
    help
        Indicates that an AT86RF215 radio is present.

config HAVE_AT86RF215IQ
    bool
    help
        Indicates that an AT86RF215IQ radio is present.

config HAVE_AT86RF215M
    bool
    help
        Indicates that an AT86RF215M radio is present.

menuconfig KCONFIG_USEMODULE_AT86RF215
    bool "Configure AT86RF215 driver"
    depends on USEMODULE_AT86RF215
    help
        Configure the AT86RF215 driver using Kconfig.

if KCONFIG_USEMODULE_AT86RF215

config AT86RF215_USE_CLOCK_OUTPUT
    bool "Enable clock output"
    help
        Enable this to enable the clock output pin of the AT86RF215 chip.
        This way it can be used as a clock source in place of a separate crystal.
        You also have to enable this if you want to measure the clock frequency
        for trimming. After proper trim value is applied this may be disabled
        if not used otherwise.
        By Default it is turned off to save energy.

config AT86RF215_TRIM_VAL_EN
    bool "Enable crystal oscillator trimming"
    help
        Enable crystal oscillator trimming.

config AT86RF215_RPC_EN
    bool "Enable Reduced Power Consumption"
    help
        Reduce Power Consumption in RX IDLE by duty-cycling the RF circuitry.

config AT86RF215_TRIM_VAL
    int "Trim value for the crystal oscillator"
    range 0 15
    default 0
    depends on AT86RF215_TRIM_VAL_EN
    help
        Each increment adds 300nF capacitance between the crystal oscillator pins
        TCXO and XTAL2.Tweak the value until the measured clock output matches
        26 MHz the best.
        For more information Refer Table 6-25 TRIM in Datasheet

config AT86RF215_RESET_PULSE_WIDTH_US
    int "Width of the reset pulse (µs)"
    range 16 1000
    default 16
    help
        If your board design includes a filtering capacitor on the reset line, this raises
        the rise time of the reset pulse.
        To accommodate for this, select a larger reset pulse width here.

        If unsure, leave this at the default value of 16 µs.

choice
    prompt "Default Modulation"

config AT86RF215_DEFAULT_LEGACY_OQPSK
    bool "legacy O-QPSK"
    help
        O-QPSK compatible with IEEE 802.15.4-2003 devices

config AT86RF215_DEFAULT_MR_OQPSK
    bool "MR-O-QPSK"
    help
        MR-O-QPSK according to IEEE 802.15.4g

config AT86RF215_DEFAULT_MR_OFDM
    bool "MR-OFDM"
    help
        MR-O-OFDM according to IEEE 802.15.4g

config AT86RF215_DEFAULT_MR_FSK
    bool "MR-FSK"
    help
        MR-FSK according to IEEE 802.15.4g

endchoice

menu "O-QPSK (802.15.4) configuration"
    depends on AT86RF215_DEFAULT_LEGACY_OQPSK

config AT86RF215_DEFAULT_OQPSK_RATE
    int "Default (legacy) O-QPSK rate mode"
    range 0 1
    default 0
    help
        The at86rf215 supports proprietary high data rates that are compatible
        with the at86rf2xx parts.
        Set this to 1 to configure the proprietary high-data rate option as default.
        If unsure, leave this at 0.

endmenu # legacy O-QPSK

menu "MR-O-QPSK (802.15.4g) configuration"
    depends on AT86RF215_DEFAULT_MR_OQPSK

config AT86RF215_DEFAULT_MR_OQPSK_RATE
    int "Default MR-O-QPSK rate mode"
    range 0 3
    default 2
    help
        Default Rate Mode of the MR-O-QPSK PHY
        Each increment doubles the PSDU data rate.

choice
    prompt "Default MR-O-QPSK Chip Rate"

config AT86RF215_DEFAULT_MR_OQPSK_CHIPS_100
    bool "100 kchip/s"

config AT86RF215_DEFAULT_MR_OQPSK_CHIPS_200
    bool "200 kchip/s"

config AT86RF215_DEFAULT_MR_OQPSK_CHIPS_1000
    bool "1000 kchip/s"

config AT86RF215_DEFAULT_MR_OQPSK_CHIPS_2000
    bool "2000 kchip/s"

endchoice

endmenu # MR-O-QPSK

menu "MR-OFDM (802.15.4g) configuration"
    depends on AT86RF215_DEFAULT_MR_OFDM

config AT86RF215_DEFAULT_MR_OFDM_OPT
    int "Default MR-OFDM option"
    range 1 4
    default 2
    help
        Default Option of the MR-OFDM PHY
        Each increment halves the PSDU data rate.

config AT86RF215_DEFAULT_MR_OFDM_MCS
    int "Default MR-OFDM Modulation & Coding Scheme"
    range 0 6
    default 2
    help
        Default Modulation & Coding Scheme of the MR-OFDM PHY.
        Higher schemes correspond to higher data rates and lower range.

        0: BPSK, rate 1⁄2, 4 x frequency repetition
        1: BPSK, rate 1⁄2, 2 x frequency repetition
        2: QPSK, rate 1⁄2, 2 x frequency repetition
        3: QPSK, rate 1⁄2
        4: QPSK, rate 3⁄4
        5: 16-QAM, rate 1⁄2
        6: 16-QAM, rate 3⁄4

endmenu

menu "MR-FSK (802.15.4g) configuration"
    depends on AT86RF215_DEFAULT_MR_FSK

config AT86RF215_DEFAULT_MR_FSK_SRATE
    int "Default MR-FSK Symbol Rate"
    range 0 5
    default 3
    help
        Default Symbol Rate of the MR-FSK PHY

        0:  50 kHz
        1: 100 kHZ
        2: 150 kHZ
        3: 200 kHZ
        4: 300 kHZ
        5: 400 kHZ

config AT86RF215_DEFAULT_MR_FSK_MOD_IDX
    int "Default MR-FSK Modulation Index"
    range 0 128
    default 64
    help
        Default Modulation Index of the MR-FSK PHY as a fraction of 64.
        (32/64 = 0.5; 64/64 = 1 …)

config AT86RF215_DEFAULT_MR_FSK_MORD
    int "Default MR-FSK Modulation Order"
    range 0 1
    default 1
    help
        Default FSK Modulation Order

        0: 2-FSK
        1: 4-FSk

config AT86RF215_DEFAULT_MR_FSK_FEC
    int "Default MR-FSK Forward Error Correction Scheme"
    range 0 2
    default 0
    help
        Default Settings for Forward Error Correction

        0: No Forward Error Correction
        1: Non-recursive and non-systematic code
        2: Recursive and systematic code

endmenu

endif # KCONFIG_USEMODULE_AT86RF215
```

## drivers/at86rf2xx/Kconfig
```kconfig
# Copyright (c) 2020 HAW Hamburg
#
# This file is subject to the terms and conditions of the GNU Lesser
# General Public License v2.1. See the file LICENSE in the top level
# directory for more details.
#

menuconfig MODULE_AT86RF2XX
    bool "AT86RF2XX IEEE 802.15.4 compatible radios"
    depends on MODULE_NETDEV_IEEE802154
    depends on TEST_KCONFIG
    select MODULE_IEEE802154
    select MODULE_XTIMER
    select HAVE_NETDEV_IEEE802154_OQPSK
    default y if MODULE_NETDEV_DEFAULT

if MODULE_AT86RF2XX

choice
    bool "Device model"
    default MODULE_AT86RF212 if HAVE_AT86RF212
    default MODULE_AT86RF212B if HAVE_AT86RF212B
    default MODULE_AT86RF233 if HAVE_AT86RF233
    default MODULE_AT86RFA1 if HAVE_AT86RFA1
    default MODULE_AT86RFR2 if HAVE_AT86RFR2
    default MODULE_AT86RF231

config MODULE_AT86RF212
    bool "AT86RF212"
    depends on HAS_PERIPH_GPIO
    depends on HAS_PERIPH_GPIO_IRQ
    depends on HAS_PERIPH_SPI
    select MODULE_PERIPH_GPIO
    select MODULE_PERIPH_GPIO_IRQ
    select MODULE_PERIPH_SPI

config MODULE_AT86RF212B
    bool "AT86RF212B"
    depends on HAS_PERIPH_GPIO
    depends on HAS_PERIPH_GPIO_IRQ
    depends on HAS_PERIPH_SPI
    select MODULE_PERIPH_GPIO
    select MODULE_PERIPH_GPIO_IRQ
    select MODULE_PERIPH_SPI

config MODULE_AT86RF231
    bool "AT86RF231"
    depends on HAS_PERIPH_GPIO
    depends on HAS_PERIPH_GPIO_IRQ
    depends on HAS_PERIPH_SPI
    select MODULE_PERIPH_GPIO
    select MODULE_PERIPH_GPIO_IRQ
    select MODULE_PERIPH_SPI

config MODULE_AT86RF233
    bool "AT86RF233"
    depends on HAS_PERIPH_GPIO
    depends on HAS_PERIPH_GPIO_IRQ
    depends on HAS_PERIPH_SPI
    select MODULE_PERIPH_GPIO
    select MODULE_PERIPH_GPIO_IRQ
    select MODULE_PERIPH_SPI

config MODULE_AT86RFA1
    bool "AT86RFA1"

config MODULE_AT86RFR2
    bool "AT86RFR2"

endchoice

config MODULE_AT86RF2XX_AES_SPI
    bool "at86rf2xx AES SPI security"

config MODULE_AUTO_INIT_AT86RF2XX
    bool "Auto initialize AT86RF2XX driver"
    depends on MODULE_AUTO_INIT
    default y

endif # MODULE_AT86RF2XX

# features to indicate that the hardware is present
config HAVE_AT86RF2XX
    bool
    help
        Indicates that an AT86RF2XX radio is present.

config HAVE_AT86RF212
    bool
    select HAVE_AT86RF2XX
    help
        Indicates that an AT86RF212 radio is present.

config HAVE_AT86RF212B
    bool
    select HAVE_AT86RF2XX
    help
        Indicates that an radio AT86RF212B is present.

config HAVE_AT86RF231
    bool
    select HAVE_AT86RF2XX
    help
        Indicates that an AT86RF231 radio is present.

config HAVE_AT86RF233
    bool
    select HAVE_AT86RF2XX
    help
        Indicates that an AT86RF233 radio is present.

config HAVE_AT86RFA1
    bool
    select HAVE_AT86RF2XX
    help
        Indicates that an AT86RFA1 radio is present.

config HAVE_AT86RFR2
    bool
    select HAVE_AT86RF2XX
    help
        Indicates that an AT86RFR2 radio is present.
```

## drivers/ata8520e/Kconfig
```kconfig
# Copyright (c) 2020 HAW Hamburg
#
# This file is subject to the terms and conditions of the GNU Lesser
# General Public License v2.1. See the file LICENSE in the top level
# directory for more details.

config HAS_ata8520e
    bool

menuconfig COMPONENT_ata8520e
    bool "Microchip ATA8520E transceiver"
    default y if HAS_ata8520e
    select HAS_HAS_NETDEV_SIGFOX
```

## drivers/bh1750fvi/Kconfig
```kconfig
# Copyright (c) 2020 HAW Hamburg
#
# This file is subject to the terms and conditions of the GNU Lesser
# General Public License v2.1. See the file LICENSE in the top level
# directory for more details.

config HAS_bh1750fvi
    bool

menuconfig COMPONENT_bh1750fvi
    bool "BH1750FVI Light Sensor"
    default y if HAS_bh1750fvi
```

## drivers/bmp180/Kconfig
```kconfig
# Copyright (c) 2020 HAW Hamburg
#
# This file is subject to the terms and conditions of the GNU Lesser
# General Public License v2.1. See the file LICENSE in the top level
# directory for more details.

config HAS_bmp180
    bool

menuconfig COMPONENT_bmp180
    bool "BMP180 temperature and pressure sensor"
    default y if HAS_bmp180 && SAUL_DEFAULT
```

## drivers/bmx280/Kconfig
```kconfig
# Copyright (c) 2020 HAW Hamburg
#
# This file is subject to the terms and conditions of the GNU Lesser
# General Public License v2.1. See the file LICENSE in the top level
# directory for more details.

config HAS_bmx280
    bool

menuconfig COMPONENT_bmx280
    bool "BMP280/BME280 temperature, pressure and humidity"
    default y if HAS_bmx280 && SAUL_DEFAULT
```

## drivers/can_trx/Kconfig
```kconfig
# Copyright (c) 2020 HAW Hamburg
#
# This file is subject to the terms and conditions of the GNU Lesser
# General Public License v2.1. See the file LICENSE in the top level
# directory for more details.

config HAS_can_trx
    bool

menuconfig COMPONENT_can_trx
    bool "Generic CAN Transceiver Interface"
    default y if HAS_can_trx
```

## drivers/cc110x/Kconfig
```kconfig
# Copyright (c) 2020 HAW Hamburg
#
# This file is subject to the terms and conditions of the GNU Lesser
# General Public License v2.1. See the file LICENSE in the top level
# directory for more details.

config HAS_cc110x
    bool

menuconfig COMPONENT_cc110x
    bool "CC1100/CC1100e/CC1101 Sub-GHz transceiver driver"
    default y if HAS_cc110x && NETDEV_DEFAULT
    select HAS_HAS_NETDEV_LORA
```

## drivers/cc2420/Kconfig
```kconfig
# Copyright (c) 2020 HAW Hamburg
#
# This file is subject to the terms and conditions of the GNU Lesser
# General Public License v2.1. See the file LICENSE in the top level
# directory for more details.

config HAS_cc2420
    bool

menuconfig COMPONENT_cc2420
    bool "CC2420 radio driver"
    default y if HAS_cc2420 && NETDEV_DEFAULT
    select HAS_HAS_NETDEV_IEEE802154
```

## drivers/ccs811/Kconfig
```kconfig
# Copyright (c) 2020 HAW Hamburg
#
# This file is subject to the terms and conditions of the GNU Lesser
# General Public License v2.1. See the file LICENSE in the top level
# directory for more details.

config HAS_ccs811
    bool

menuconfig COMPONENT_ccs811
    bool "CCS811 digital Gas Sensor"
    default y if HAS_ccs811 && SAUL_DEFAULT
```

## drivers/dose/Kconfig
```kconfig
# Copyright (c) 2020 HAW Hamburg
#
# This file is subject to the terms and conditions of the GNU Lesser
# General Public License v2.1. See the file LICENSE in the top level
# directory for more details.

config HAS_dose
    bool

menuconfig COMPONENT_dose
    bool "Differentially Operated Serial Ethernet"
    default y if HAS_dose
    select HAS_HAS_NETDEV_ETHERNET
```
