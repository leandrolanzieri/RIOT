#define HAS_USART1
#define HAS_USART2
#define HAS_USART3
#define HAS_USART4
#define HAS_USART5

#define HAS_SPI1
#define HAS_SPI2
#define HAS_SPI3

#define HAS_DMA1
#define HAS_DMA2

#define HAS_I2C1
#define HAS_I2C2

#define HAS_ADC

#include "../stm32l1.dtsi"

/ {
    soc {
        compatible = "st,stm32l152re", "st,stm32l152", "st,stm32l1";
    };
};
