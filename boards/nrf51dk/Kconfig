## boards/nrf51dk/Kconfig
```kconfig
config HAS_periph_i2c
    default y

config HAS_periph_spi
    default y

config HAS_periph_uart
    default y
```

## boards/nrf52840dk/Kconfig
```kconfig
config HAS_radio_nrf802154
    default y

config HAS_periph_pwm
    default y

config HAS_periph_usbdev
    default y

source "$(RIOTBOARD)/common/nrf52xxxdk/Kconfig"
```

## boards/nucleo-f031k6/Kconfig
```kconfig
config HAS_periph_adc
    default y

config HAS_periph_pwm
    default y

config HAS_periph_rtc
    default y

config HAS_periph_spi
    default y

config HAS_periph_timer
    default y

config HAS_periph_uart
    default y
```

## boards/nucleo-f070rb/Kconfig
```kconfig
config HAS_periph_adc
    default y

config HAS_periph_i2c
    default y

config HAS_periph_pwm
    default y

config HAS_periph_rtc
    default y

config HAS_periph_timer
    default y

config HAS_periph_uart
    default y
```

## boards/nucleo-f072rb/Kconfig
```kconfig
config BOARD_NUCLEO_F072RB
    bool
    default y
    select HAS_periph_adc
    select HAS_periph_i2c
    select HAS_periph_pwm
    select HAS_periph_rtc
    select HAS_periph_timer
    select HAS_periph_uart
    select HAS_periph_spi
    select CPU_STM32_COMMON

config COMPONENT_boards_common_nucleo
    bool
    default y
```

## boards/nucleo-f207zg/Kconfig
```kconfig
config HAS_periph_dma
    default y

config HAS_periph_eth
    default y

config HAS_periph_i2c
    default y

config HAS_periph_pwm
    default y

config HAS_periph_rtc
    default y

config HAS_periph_spi
    default y

config HAS_periph_timer
    default y

config HAS_periph_uart
    default y

config HAS_riotboot
    default y

rsource "../common/nucleo144/Kconfig"
```

## boards/nucleo-f446re/Kconfig
```kconfig
config HAS_periph_adc
    default y

config HAS_periph_i2c
    default y

config HAS_periph_pwm
    default y

config HAS_periph_rtc
    default y

config HAS_periph_spi
    default y

config HAS_periph_timer
    default y

config HAS_periph_uart
    default y

config HAS_periph_qdec
    default y

config HAS_motor_driver
    default y

config HAS_riotboot
    default y
```

## boards/nucleo-l152re/Kconfig
```kconfig
config HAS_periph_adc
    default y

config HAS_periph_dac
    default y

config HAS_periph_dma
    default y

config HAS_periph_i2c
    default y

config HAS_periph_pwm
    default y

config HAS_periph_rtc
    default y

config HAS_periph_spi
    default y

config HAS_periph_spi_gpio_mode
    default y

config HAS_periph_timer
    default y

config HAS_periph_uart
    default y

config HAS_riotboot
    default y

# TODO: Define in common

config COMPONENT_boards_common_nucleo
    bool
    default y
```

## boards/nucleo-l152re/board.yml
```yaml
board:
  name: 'Nucleo L152RE'
  cpu: 'stm32l152re'
  description: >
    STM32 Nucleo-64 development board with STM32L152RE MCU, supports Arduino
    and ST morpho connectivity.
  pinmap:
    CN5:
      - label: 'D8'
        pin: 'PORT_A9'
      - label: 'PWM/D9'
        pin: 'PORT_C7'
      - label: 'PWM/CS/D10'
        pin: 'PORT_B6'
      - label: 'PWM/MOSI/D11'
        pin: 'PORT_A7'
      - label: 'MISO/D12'
        pin: 'PORT_A6'
      - label: 'SCK/D13'
        pin: 'PORT_A5'
      - label: 'GND'
        pin: 'GND'
      - label: 'AVDD'
        pin: 'AVDD'
      - label: 'SDA/D14'
        pin: 'PORT_B9'
      - label: 'SCL/D15'
        pin: 'PORT_B8'
    CN6:
      - label: 'NC'
        pin: 'NC'
      - label: 'IOREF'
        pin: 'IOREF'
      - label: 'RESET'
        pin: 'RESET'
      - label: '+3V3'
        pin: '+3V3'
      - label: '+5V'
        pin: '+5V'
      - label: 'GND'
        pin: 'GND'
      - label: 'GND'
        pin: 'GND'
      - label: 'VIN'
        pin: 'VIN'
    CN7:
      - label: 'PC10'
        pin: 'PORT_C10'
      - label: 'PC11'
        pin: 'PORT_C11'
      - label: 'PC12'
        pin: 'PORT_C12'
      - label: 'PD2'
        pin: 'PORT_D2'
      - label: 'VDD'
        pin: 'VDD'
      - label: 'E5V'
        pin: 'E5V'
      - label: 'BOOT0'
        pin: 'BOOT0'
      - label: 'GND'
        pin: 'GND'
      - label: 'NC'
        pin: 'NC'
      - label: 'NC'
        pin: 'NC'
      - label: 'NC'
        pin: 'NC'
      - label: 'IOREF'
        pin: 'IOREF'
      - label: 'PA13'
        pin: 'PORT_A13'
      - label: 'RESET'
        pin: 'RESET'
      - label: 'PA14'
        pin: 'PORT_A14'
      - label: '+3V3'
        pin: '+3V3'
      - label: 'PA15'
        pin: 'PORT_A15'
      - label: '+5V'
        pin: '+5V'
      - label: 'GND'
        pin: 'GND'
      - label: 'GND'
        pin: 'GND'
      - label: 'PB7'
        pin: 'PORT_B7'
      - label: 'GND'
        pin: 'GND'
      - label: 'PC13'
        pin: 'PORT_C13'
      - label: 'VIN'
        pin: 'VIN'
      - label: 'PC14'
        pin: 'PORT_C14'
      - label: 'NC'
        pin: 'NC'
      - label: 'PC15'
        pin: 'PORT_C15'
      - label: 'PA0'
        pin: 'PORT_A0'
      - label: 'PH0'
        pin: 'PORT_H0'
      - label: 'PA1'
        pin: 'PORT_A1'
      - label: 'PH1'
        pin: 'PORT_H1'
      - label: 'PA4'
        pin: 'PORT_A4'
      - label: 'VBAT'
        pin: 'VBAT'
      - label: 'PB0'
        pin: 'PORT_B0'
      - label: 'PC2'
        pin: 'PORT_C2'
      - label: 'PC1'
        pin: 'PORT_C1'
      - label: 'PC3'
        pin: 'PORT_C3'
      - label: 'PC0'
        pin: 'PORT_C0'
    CN8:
      - label: 'A0'
        pin: 'PORT_A0'
      - label: 'A1'
        pin: 'PORT_A1'
      - label: 'A2'
        pin: 'PORT_A4'
      - label: 'A3'
        pin: 'PORT_B0'
      - label: 'A4'
        pin: 'PORT_C1'
      - label: 'A5'
        pin: 'PORT_C0'
    CN9:
      - label: 'RX/D0'
        pin: 'PORT_A3'
      - label: 'TX/D1'
        pin: 'PORT_A2'
      - label: 'D2'
        pin: 'PORT_A10'
      - label: 'PWM/D3'
        pin: 'PORT_B3'
      - label: 'D4'
        pin: 'PORT_B5'
      - label: 'PWM/D5'
        pin: 'PORT_B4'
      - label: 'PWM/D6'
        pin: 'PORT_B10'
      - label: 'D7'
        pin: 'PORT_A8'
    CN10:
      - label: 'PC9'
        pin: 'PORT_C9'
      - label: 'PC8'
        pin: 'PORT_C8'
      - label: 'PB8'
        pin: 'PORT_B8'
      - label: 'PC6'
        pin: 'PORT_C6'
      - label: 'PB9'
        pin: 'PORT_B9'
      - label: 'PC5'
        pin: 'PORT_C5'
      - label: 'AVDD'
        pin: 'AVDD'
      - label: 'U5V'
        pin: 'U5V'
      - label: 'GND'
        pin: 'GND'
      - label: 'NC'
        pin: 'NC'
      - label: 'PA5'
        pin: 'PORT_A5'
      - label: 'PA12'
        pin: 'PORT_A12'
      - label: 'PA6'
        pin: 'PORT_A6'
      - label: 'PA11'
        pin: 'PORT_A11'
      - label: 'PA7'
        pin: 'PORT_A7'
      - label: 'PB12'
        pin: 'PORT_B12'
      - label: 'PB6'
        pin: 'PORT_B6'
      - label: 'PB11'
        pin: 'PORT_B11'
      - label: 'PC7'
        pin: 'PORT_C7'
      - label: 'GND'
        pin: 'GND'
      - label: 'PA9'
        pin: 'PORT_A9'
      - label: 'PB2'
        pin: 'PORT_B2'
      - label: 'PA8'
        pin: 'PORT_A8'
      - label: 'PB1'
        pin: 'PORT_B1'
      - label: 'PB10'
        pin: 'PORT_B10'
      - label: 'PB15'
        pin: 'PORT_B15'
      - label: 'PB4'
        pin: 'PORT_B4'
      - label: 'PB14'
        pin: 'PORT_B14'
      - label: 'PB5'
        pin: 'PORT_B5'
      - label: 'PB13'
        pin: 'PORT_B13'
      - label: 'PB3'
        pin: 'PORT_B3'
      - label: 'AGND'
        pin: 'AGND'
      - label: 'PA10'
        pin: 'PORT_A10'
      - label: 'PC4'
        pin: 'PORT_C4'
      - label: 'PA2'
        pin: 'PORT_A2'
      - label: 'NC'
        pin: 'NC'
      - label: 'PA3'
        pin: 'PORT_A3'
      - label: 'NC'
        pin: 'NC'
    BTN:
      - label: 'USER/B1'
        pin: 'PORT_C13'
      - label: 'RESET/B2'
        pin: 'RESET'
    LED:
      - label: 'LD2'
        pin: 'PORT_A5'
```

## boards/nucleo-l432kc/Kconfig
```kconfig
config HAS_periph_i2c
    default y

config HAS_periph_pwm
    default y

config HAS_periph_rtc
    default y

config HAS_periph_rtt
    default y

config HAS_periph_spi
    default y

config HAS_periph_timer
    default y

config HAS_periph_uart
    default y

config HAS_riotboot
    default y
```

## boards/pic32-clicker/Kconfig
```kconfig
config HAS_periph_gpio
    default y

config HAS_periph_timer
    default y

config HAS_periph_uart
    default y
```

## boards/samr21-xpro/Kconfig
```kconfig
config BOARD_SAMR21_XPRO
    bool
    default y
    select HAS_periph_adc
    select HAS_periph_i2c
    select HAS_periph_pwm
    select HAS_periph_rtc
    select HAS_periph_rtt
    select HAS_periph_spi
    select HAS_periph_timer
    select HAS_periph_uart
    select HAS_periph_usbdev
    select HAS_riotboot
    select CPU_CORTEXM_COMMON
    select HAS_at86rf233
```

## boards/samr21-xpro/board.yml
```yaml
board:
  name: 'SAMR21 XPLAINED PRO'
  cpu: 'samr21g18'
  pinmap:
    EXT1:
      - label: 'ID'
        pin: 'ID'
      - label: 'GND'
        pin: 'GND'
      - label: 'PA06'
        pin: 'PA6'
      - label: 'PA07'
        pin: 'PA7'
      - label: 'PA13'
        pin: 'PA13'
      - label: 'PA28'
        pin: 'PA28'
      - label: 'PA18'
        pin: 'PA18'
      - label: 'PA19'
        pin: 'PA19'
      - label: 'PA22'
        pin: 'PA22'
      - label: 'PA23'
        pin: 'PA23'
      - label: 'PA16'
        pin: 'PA16'
      - label: 'PA17'
        pin: 'PA17'
      - label: 'PA05'
        pin: 'PA5'
      - label: 'PA04'
        pin: 'PA4'
      - label: 'PB03'
        pin: 'PB3'
      - label: 'PB22'
        pin: 'PB22'
      - label: 'PB02'
        pin: 'PB2'
      - label: 'PB23'
        pin: 'PB23'
      - label: 'GND'
        pin: 'GND'
      - label: 'VCC'
        pin: 'VCC'
    EXT3:
      - label: 'VCC'
        pin: 'VCC'
      - label: 'GND'
        pin: 'GND'
      - label: 'PB23'
        pin: 'PB23'
      - label: 'PB02'
        pin: 'PB2'
      - label: 'PB22'
        pin: 'PB22'
      - label: 'PA14'
        pin: 'PA14'
      - label: 'NC'
        pin: 'NC'
      - label: 'NC'
        pin: 'NC'
      - label: 'PA17'
        pin: 'PA17'
      - label: 'PA16'
        pin: 'PA16'
      - label: 'PA08'
        pin: 'PA8'
      - label: 'NC'
        pin: 'NC'
      - label: 'NC'
        pin: 'NC'
      - label: 'NC'
        pin: 'NC'
      - label: 'NC'
        pin: 'NC'
      - label: 'PA15'
        pin: 'PA15'
      - label: 'NC'
        pin: 'NC'
      - label: 'NC'
        pin: 'NC'
      - label: 'GND'
        pin: 'GND'
      - label: 'ID'
        pin: 'ID'
    BTN:
      - label: 'SWD'
        pin: 'PA28'
      - label: 'RESET'
        pin: 'RESET'
    LED:
      - label: 'LED0'
        pin: 'PA19'
```

## boards/slstk3402a/Kconfig
```kconfig
config HAS_periph_adc
    default y

config HAS_periph_i2c
    default y

config HAS_periph_rtc
    default y

config HAS_periph_rtt
    default y

config HAS_periph_spi
    default y

config HAS_periph_timer
    default y

config HAS_periph_uart
    default y

config HAS_periph_uart_modecfg
    default y

config BOARD_SLSTK3402A
    bool
    default y
    select CPU_EFM32_PG12B
    select COMPONENT_boards_common_silabs
    select COMPONENT_silabs_aem
    select COMPONENT_silabs_bc

source "$(RIOTBOARD)/common/silabs/Kconfig"
```

## boards/spark-core/Kconfig
```kconfig
config HAS_periph_timer
    default y

config HAS_periph_spi
    default y

config HAS_periph_uart
    default y
```

## core/Kconfig.log
```kconfig
menuconfig KCONFIG_LOG
    bool "Configure System Log"

if KCONFIG_LOG

choice
    prompt "System Log level"
    default LOG_LEVEL_INFO

config LOG_LEVEL_ALL
    bool "All"
    help
        Prints everything

config LOG_LEVEL_DEBUG
    bool "Debug"
    help
        Prints developer stuff considered too verbose for production use.

config LOG_LEVEL_INFO
    bool "Info"
    help
        Prints purely informational message like successful system bootup,
        network link state, ...

config LOG_LEVEL_WARNING
    bool "Warning"
    help
        Prints warning messages for temporary errors.

config LOG_LEVEL_ERROR
    bool "Error"
    help
        Prints only critical, non-recoverable errors like hardware
        initialization failures.

config LOG_LEVEL_NONE
    bool "None"
    help
        Prints nothing.

endchoice

endif # KCONFIG_LOG
```

## core/Kconfig.sched
```kconfig
menuconfig KCONFIG_SCHED
    bool "Configure scheduler"

if KCONFIG_SCHED

config SCHED_PRIO_LEVELS
    int "Number of thread priority levels"
    default 16

config CONFIG_MAXTHREADS
    int "Maximum number of threads to be scheduled"
    default 32

endif # KCONFIG_SCHED
```

## core/Kconfig.thread
```kconfig
menuconfig KCONFIG_THREAD
    bool "Configure Threads"
    help
        Enable this to configure Threads using Kconfig.

if KCONFIG_THREAD

config THREAD_STACKSIZE_DEFAULT
    int "Default stack size in bytes"
    help
        A reasonable default stack size that will suffice most smaller tasks.

config THREAD_STACKSIZE_MAIN
    int "Main task's stack size in bytes"

config THREAD_STACKSIZE_IDLE
    int "Idle task stack size in bytes"
    help
        Size of the idle task's stack.

config THREAD_EXTRA_STACKSIZE_PRINTF
    int "printf stack size in bytes"
    help
        Size of the task's printf stack.

endif # KCONFIG_THREAD
```

## cpu/Kconfig
```kconfig
rsource "Kconfig.features"

config COMPONENT_periph
    bool

config COMPONENT_periph_common
    bool
    select COMPONENT_periph

config COMPONENT_periph_gpio
    bool
    default HAS_periph_gpio
    depends on HAS_periph_gpio
    select COMPONENT_periph_common

config COMPONENT_periph_init_gpio
    bool
    default y
    depends on COMPONENT_periph_gpio

config COMPONENT_periph_gpio_irq
    bool
    default HAS_periph_gpio_irq
    depends on HAS_periph_gpio_irq
    select COMPONENT_periph_common

config COMPONENT_periph_mcg
    bool
    default y
    depends on HAS_periph_mcg

config COMPONENT_periph_spi
    bool
    default HAS_periph_spi
    depends on HAS_periph_spi
    select COMPONENT_periph_common

config COMPONENT_periph_cpuid
    bool
    default HAS_periph_cpuid
    depends on HAS_periph_cpuid
    select COMPONENT_periph_common

config COMPONENT_periph_hwrng
    bool
    default HAS_periph_hwrng
    depends on HAS_periph_hwrng
    select COMPONENT_periph_common

config COMPONENT_periph_pm
    bool
    default HAS_periph_pm
    depends on HAS_periph_pm
    select COMPONENT_periph_common

config COMPONENT_periph_init_pm
    bool
    default y
    depends on COMPONENT_periph_pm

config COMPONENT_periph_spi_gpio_mode
    bool
    default HAS_periph_spi_gpio_mode
    depends on HAS_periph_spi_gpio_mode
    select COMPONENT_periph_common

config COMPONENT_periph_uart
    bool
    default HAS_periph_uart
    depends on HAS_periph_uart
    select COMPONENT_periph_common

config COMPONENT_periph_init_uart
    bool
    default y
    depends on COMPONENT_periph_uart

config COMPONENT_native_drivers
    default n
    bool

config COMPONENT_newlib
    bool

config COMPONENT_newlib_nano
    bool

config COMPONENT_newlib_syscalls_default
    bool
```
